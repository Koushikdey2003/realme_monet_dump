/dts-v1/;

/ {

	fragment@0 {
		target = <0xffffffff>;

		__overlay__ {

			reserve-memory-scp_share {
				compatible = "mediatek,reserve-memory-scp_share";
				no-map;
				size = <0x00 0xd00000>;
				alignment = <0x00 0x1000000>;
				alloc-ranges = <0x00 0x40000000 0x00 0x50000000>;
			};
		};
	};

	fragment@1 {
		target = <0xffffffff>;

		__overlay__ {
			atag,videolfb-fb_base_l = "~`P";
			atag,videolfb-fb_base_h = <0x00>;
			atag,videolfb-islcmfound = <0x01>;
			atag,videolfb-islcm_inited = <0x00>;
			atag,videolfb-fps = <0x1770>;
			atag,videolfb-vramSize = <0x17e8000>;
			atag,videolfb-lcmname = "hx83112b_fhdp_dsi_cmd_auo_rt5081_drv";
		};
	};

	fragment@2 {
		target = <0xffffffff>;

		__overlay__ {

			led@0 {
				compatible = "mediatek,red";
				led_mode = <0x00>;
				data = <0x01>;
				pwm_config = <0x00 0x00 0x00 0x00 0x00>;
				phandle = <0x4f>;
			};

			led@1 {
				compatible = "mediatek,green";
				led_mode = <0x00>;
				data = <0x01>;
				pwm_config = <0x00 0x00 0x00 0x00 0x00>;
				phandle = <0x50>;
			};

			led@2 {
				compatible = "mediatek,blue";
				led_mode = <0x00>;
				data = <0x01>;
				pwm_config = <0x00 0x00 0x00 0x00 0x00>;
				phandle = <0x51>;
			};

			led@3 {
				compatible = "mediatek,jogball-backlight";
				led_mode = <0x00>;
				data = <0x01>;
				pwm_config = <0x00 0x00 0x00 0x00 0x00>;
				phandle = <0x52>;
			};

			led@4 {
				compatible = "mediatek,keyboard-backlight";
				led_mode = <0x00>;
				data = <0x01>;
				pwm_config = <0x00 0x00 0x00 0x00 0x00>;
				phandle = <0x53>;
			};

			led@5 {
				compatible = "mediatek,button-backlight";
				led_mode = <0x00>;
				data = <0x01>;
				pwm_config = <0x00 0x00 0x00 0x00 0x00>;
				phandle = <0x54>;
			};

			led@6 {
				compatible = "mediatek,lcd-backlight";
				led_mode = <0x04>;
				led_rm = <0x01>;
				data = <0x01>;
				pwm_config = <0x00 0x03 0x00 0x00 0x00>;
				phandle = <0x55>;
			};

			vibrator@0 {
				compatible = "mediatek,vibrator";
				vib_timer = <0x32>;
				vib_limit = <0x09>;
				vib_vol = <0x09>;
				phandle = <0x56>;
			};

			gsensor_1 {
				status = "okay";
				sensor_name = <0x07>;
				i2c_num = <0x01>;
				i2c_addr = <0x00>;
				direction = <0x05>;
				eint_num = <0x02>;
				step_count_7_en = <0x01>;
				config_miso = <0x01>;
				correct_y_bias = <0x01>;
				phandle = <0x57>;
			};

			gsensor_2 {
				status = "okay";
				sensor_name = <0x08>;
				i2c_num = <0x01>;
				i2c_addr = <0x00>;
				direction = <0x05>;
				eint_num = <0x02>;
				step_count_7_en = <0x01>;
				config_miso = <0x01>;
				correct_y_bias = <0x01>;
				phandle = <0x58>;
			};

			msensor_1 {
				status = "okay";
				sensor_name = <0x02>;
				i2c_num = <0x00>;
				i2c_addr = <0x30>;
				direction = <0x00>;
				eint_num = <0x00>;
				phandle = <0x59>;
			};

			msensor_2 {
				status = "okay";
				sensor_name = <0x00>;
				i2c_num = <0x00>;
				i2c_addr = <0x0c>;
				direction = <0x00>;
				eint_num = <0x00>;
				phandle = <0x5a>;
			};

			proximity_1 {
				status = "okay";
				sensor_name = <0x0a>;
				ps_type = <0x02>;
				pd0_range = <0x01>;
				phandle = <0x5b>;
			};

			light_1 {
				status = "okay";
				sensor_name = <0x0a>;
				als_type = <0x01>;
				phandle = <0x5c>;
			};

			pick_up {
				status = "okay";
				use-proximity = <0x01>;
				phandle = <0x5d>;
			};

			lux_aod {
				status = "okay";
				use-proximity = <0x01>;
				phandle = <0x5e>;
			};

			alsps_arch {
				status = "okay";
				new-arch-supported = <0x00>;
				phandle = <0x5f>;
			};

			mtk_cali {
				status = "okay";
				mtk-cali-supported = <0x01>;
				phandle = <0x60>;
			};

			oplus_project {
				compatible = "oppo,oplus_project";
				phandle = <0x61>;
			};

			oppo_devinfo {
				compatible = "oppo-devinfo";
				phandle = <0x62>;
			};

			swtp {
				compatible = "mediatek, swtp-eint";
				interrupt-parent = <0xffffffff>;
				interrupts = <0x39 0x04 0x39 0x00>;
				deb-gpios = <0xffffffff 0x39 0x00>;
				debounce = <0x3e800>;
				status = "okay";
				phandle = <0x63>;
			};

			kpd_volume_down {
				compatible = "mediatek, VOLUME_DOWN-eint";
				interrupt-parent = <0xffffffff>;
				interrupts = <0x5e 0x02 0x5e 0x00>;
				debounce = <0x7d00>;
				status = "okay";
				phandle = <0x64>;
			};

			nfc_chipset {
				compatible = "oppo-nfc-chipset";
				chipset-19741 = "NQ310";
				phandle = <0x65>;
			};
		};
	};

	fragment@3 {
		target = <0xffffffff>;

		__overlay__ {
			keypad,volume-down = <0xffffffff 0x5e 0x00>;
			pinctrl-names = "volume_down_as_int";
			pinctrl-0 = <0x01>;
			status = "okay";
		};
	};

	fragment@4 {
		target = <0xffffffff>;

		__overlay__ {

			volume_down@0 {
				phandle = <0x01>;

				pins_cmd_dat {
					pinmux = <0x5e00>;
					slew-rate = <0x00>;
					input-enable;
				};
			};
		};
	};

	fragment@5 {
		target = <0xffffffff>;

		__overlay__ {
			clock-frequency = <0x61a80>;

			mtk-usb@60 {
				compatible = "mediatek,mtk-usb";
				reg = <0x60>;
				status = "okay";
			};
		};
	};

	fragment@6 {
		target = <0xffffffff>;

		__overlay__ {
			status = "okay";

			nfc_nxp@28 {
				compatible = "nxp,pn544";
				reg = <0x28>;
				nxp,pn544-irq = <0xffffffff 0x06 0x00>;
				nxp,pn544-ven = <0xffffffff 0x36 0x00>;
				nxp,pn544-fw-dwnld = <0xffffffff 0x13 0x00>;
				interrupt-parent = <0xffffffff>;
			};
		};
	};

	fragment@7 {
		target = <0xffffffff>;

		__overlay__ {
			pinctrl-names = "uart0_rx_gpio\0uart0_tx_gpio";
			pinctrl-0 = <0x02>;
			pinctrl-1 = <0x03>;
			status = "okay";
		};
	};

	fragment@8 {
		target = <0xffffffff>;

		__overlay__ {

			uart0_rx_gpio@gpio95 {
				phandle = <0x02>;

				pins_cmd_dat {
					pinmux = <0x5f00>;
					input-enable;
					slew-rate = <0x00>;
					bias-pull-down;
				};
			};

			uart0_tx_gpio@gpio96 {
				phandle = <0x03>;

				pins_cmd_dat {
					pinmux = <0x6000>;
					input-enable;
					slew-rate = <0x00>;
					bias-pull-down;
				};
			};
		};
	};

	fragment@9 {
		target = <0xffffffff>;

		__overlay__ {
			mtk,usb-type = <0x01>;
		};
	};

	fragment@10 {
		target = <0xffffffff>;

		__overlay__ {
			fast_charge_voltage = <0x2f4d60>;
			ac_charger_current = <0x7a120>;
			ac_charger_input_current = <0x7a120>;
			ta_ac_charger_current = <0x7a120>;
			temp_t4_threshold = <0x35>;
			temp_t3_threshold = <0x2c>;
			temp_t1_threshold = <0x00>;
		};
	};

	fragment@11 {
		target = <0xffffffff>;

		__overlay__ {
			compatible = "mediatek,charger";
			qcom,input_current_charger_ma = <0x7d0>;
			qcom,input_current_cdp_ma = <0x5dc>;
			qcom,input_current_usb_ma = <0x1f4>;
			qcom,input_current_led_ma = <0x4b0>;
			qcom,input_current_led_ma_forcmcc = <0x1f4>;
			qcom,input_current_camera_ma = <0x4b0>;
			qcom,input_current_calling_ma = <0x4b0>;
			qcom,input_current_led_ma_high = <0x4b0>;
			qcom,input_current_led_ma_warm = <0x5dc>;
			qcom,input_current_led_ma_normal = <0x7d0>;
			qcom,led_high_bat_decidegc = <0x172>;
			qcom,led_warm_bat_decidegc = <0x15e>;
			qcom,iterm_disabled = <0x00>;
			qcom,iterm_ma = <0x109>;
			qcom,recharge-mv = <0x73>;
			qcom,batt_capacity_mah = <0x1388>;
			qcom,removed_bat_decidegc = <0xbe>;
			qcom,cold_bat_decidegc = <0x14>;
			qcom,temp_cold_vfloat_mv = <0xf8c>;
			qcom,temp_cold_fastchg_current_ma = <0x15e>;
			qcom,little_cold_bat_decidegc = <0x00>;
			qcom,temp_little_cold_vfloat_mv = <0x1153>;
			qcom,temp_little_cold_fastchg_current_ma_high = <0x28a>;
			qcom,temp_little_cold_fastchg_current_ma_low = <0x28a>;
			qcom,temp_little_cold_fastchg_current_ma = <0x28a>;
			qcom,temp_little_cold_usbchg_current_ma_high = <0x28a>;
			qcom,temp_little_cold_usbchg_current_ma_low = <0x28a>;
			qcom,temp_little_cold_usbchg_current_ma = <0x28a>;
			qcom,qc_temp_little_cold_fastchg_current_ma_high = <0x898>;
			qcom,qc_temp_little_cold_fastchg_current_ma_low = <0x898>;
			qcom,cool_bat_decidegc = <0x32>;
			qcom,temp_cool_vfloat_mv = <0x1153>;
			qcom,temp_cool_fastchg_current_ma_high = <0x546>;
			qcom,temp_cool_fastchg_current_ma_low = <0x28a>;
			qcom,temp_cool_usbchg_current_ma_high = <0x28a>;
			qcom,temp_cool_usbchg_current_ma_low = <0x226>;
			qcom,qc_temp_cool_fastchg_current_ma_high = <0xabe>;
			qcom,qc_temp_cool_fastchg_current_ma_low = <0xabe>;
			qcom,little_cool_bat_decidegc = <0x78>;
			qcom,temp_little_cool_vfloat_mv = <0x1153>;
			qcom,temp_little_cool_fastchg_current_ma = <0x802>;
			qcom,temp_little_cool_usbchg_current_ma = <0x226>;
			qcom,temp_little_cool_fastchg_current_ma_high = <0x802>;
			qcom,temp_little_cool_fastchg_current_ma_low = <0x802>;
			qcom,qc_temp_little_cool_fastchg_current_ma = <0xd48>;
			qcom,normal_bat_decidegc = <0xa0>;
			qcom,temp_normal_fastchg_current_ma = <0x7d0>;
			qcom,temp_normal_usbchg_current_ma = <0x226>;
			qcom,temp_normal_vfloat_mv = <0x1153>;
			qcom,pd_temp_normal_fastchg_current_ma = <0xbb8>;
			qcom,qc_temp_normal_fastchg_current_ma = <0xbb8>;
			qcom,warm_bat_decidegc = <0x1b8>;
			qcom,temp_warm_vfloat_mv = <0x1022>;
			qcom,temp_warm_fastchg_current_ma = <0x4b0>;
			qcom,temp_warm_usbchg_current_ma = <0x226>;
			qcom,temp_warm_fastchg_current_ma_led_on = <0x1f4>;
			qcom,qc_temp_warm_fastchg_current_ma = <0x546>;
			qcom,hot_bat_decidegc = <0x212>;
			qcom,non_standard_vfloat_mv = <0xf8c>;
			qcom,non_standard_fastchg_current_ma = <0x200>;
			qcom,short_c_bat_cv_mv = <0x10ea>;
			qcom,short_c_bat_vfloat_mv = <0xed8>;
			qcom,short_c_bat_fastchg_current_ma = <0x200>;
			qcom,short_c_bat_vfloat_sw_limit = <0xea6>;
			qcom,cold_vfloat_sw_limit = <0xf5a>;
			qcom,little_cold_vfloat_sw_limit = <0x111c>;
			qcom,cool_vfloat_sw_limit = <0x111c>;
			qcom,little_cool_vfloat_sw_limit = <0x111c>;
			qcom,normal_vfloat_sw_limit = <0x111c>;
			qcom,warm_vfloat_sw_limit = <0xff0>;
			qcom,non_standard_vfloat_sw_limit = <0xf5a>;
			qcom,normal_phase1_bat_decidegc = <0xa0>;
			qcom,temp_normal_phase1_vfloat_mv = <0x1153>;
			qcom,temp_normal_phase1_fastchg_current_ma = <0x898>;
			qcom,normal_phase2_bat_decidegc = <0xdc>;
			qcom,temp_normal_phase2_vfloat_mv = <0x1153>;
			qcom,temp_normal_phase2_fastchg_current_ma_high = <0x802>;
			qcom,temp_normal_phase2_fastchg_current_ma_low = <0x802>;
			qcom,normal_phase3_bat_decidegc = <0x154>;
			qcom,temp_normal_phase3_vfloat_mv = <0x1153>;
			qcom,temp_normal_phase3_fastchg_current_ma_high = <0x5dc>;
			qcom,temp_normal_phase3_fastchg_current_ma_low = <0x5dc>;
			qcom,normal_phase4_bat_decidegc = <0x172>;
			qcom,temp_normal_phase4_vfloat_mv = <0x1153>;
			qcom,temp_normal_phase4_fastchg_current_ma_high = <0x4e2>;
			qcom,temp_normal_phase4_fastchg_current_ma_low = <0x4e2>;
			qcom,normal_phase5_bat_decidegc = <0x190>;
			qcom,temp_normal_phase5_vfloat_mv = <0x1153>;
			qcom,temp_normal_phase5_fastchg_current_ma = <0x4e2>;
			qcom,normal_phase6_bat_decidegc = <0x1a4>;
			qcom,temp_normal_phase6_vfloat_mv = <0x1153>;
			qcom,temp_normal_phase6_fastchg_current_ma = <0x4b0>;
			qcom,max_chg_time_sec = <0x8ca0>;
			qcom,charger_hv_thr = <0x16a8>;
			qcom,charger_recv_thr = <0x16a8>;
			qcom,charger_lv_thr = <0xd48>;
			qcom,vbatt_full_thr = <0x1130>;
			qcom,vbatt_hv_thr = <0x11c6>;
			qcom,vfloat_step_mv = <0x0a>;
			qcom,non_standard_vfloat_over_sw_limit = <0xfa0>;
			qcom,cold_vfloat_over_sw_limit = <0xfa0>;
			qcom,little_cold_vfloat_over_sw_limit = <0x1162>;
			qcom,cool_vfloat_over_sw_limit = <0x1162>;
			qcom,little_cool_vfloat_over_sw_limit = <0x1162>;
			qcom,normal_vfloat_over_sw_limit = <0x1162>;
			qcom,warm_vfloat_over_sw_limit = <0x1036>;
			qcom,vbatt_power_off = <0xce4>;
			qcom,vbatt_soc_1 = <0xd52>;
			qcom,vooc_project = <0x00>;
			qcom,vbatt_num = <0x01>;
			qcom,normal_vterm_hw_inc = <0x96>;
			qcom,non_normal_vterm_hw_inc = <0x0a>;
			qcom,ff1_normal_fastchg_ma = <0x440>;
			qcom,ffc2_normal_fastchg_ma = <0x30c>;
			qcom,ffc2_temp_warm_decidegc = <0x15e>;
			qcom,ffc2_warm_fastchg_ma = <0x348>;
			qcom,ffc2_temp_high_decidegc = <0x190>;
			qcom,ffc2_temp_low_decidegc = <0x78>;
			qcom,ff1_exit_step_ma = <0x1e8>;
			qcom,ff1_warm_exit_step_ma = <0x1a2>;
			qcom,ffc2_exit_step_ma = <0xb4>;
			qcom,ffc2_warm_exit_step_ma = <0xaa>;
			qcom,ffc_normal_vfloat_sw_limit = <0x114e>;
			qcom,ffc_temp_normal_vfloat_mv = <0x1194>;
			qcom,ffc_normal_vfloat_over_sw_limit = <0x1194>;
			qcom,default_iterm_ma = <0x109>;
			qcom,default_temp_normal_fastchg_current_ma = <0x7d0>;
			qcom,default_normal_vfloat_sw_limit = <0x111c>;
			qcom,default_temp_normal_vfloat_mv = <0x1153>;
			qcom,default_normal_vfloat_over_sw_limit = <0x1162>;
			qcom,iterm_ma_2nd = <0x12c>;
			qcom,recharge-mv_2nd = <0x79>;
			qcom,temp_little_cold_vfloat_mv_2nd = <0x1127>;
			qcom,temp_cool_vfloat_mv_2nd = <0x1127>;
			qcom,temp_little_cool_vfloat_mv_2nd = <0x1127>;
			qcom,temp_normal_vfloat_mv_2nd = <0x1127>;
			qcom,little_cold_vfloat_over_sw_limit_2nd = <0x112b>;
			qcom,cool_vfloat_over_sw_limit_2nd = <0x112b>;
			qcom,little_cool_vfloat_over_sw_limit_2nd = <0x112b>;
			qcom,normal_vfloat_over_sw_limit_2nd = <0x112b>;
			qcom,default_iterm_ma_2nd = <0x12c>;
			qcom,default_temp_normal_vfloat_mv_2nd = <0x1127>;
			qcom,default_normal_vfloat_over_sw_limit_2nd = <0x112b>;
			qcom,check_batt_full_by_sw;
			qcom,chg_ctrl_by_calling;
			qcom,chg_ctrl_by_lcd;
			qcom,chg_ctrl_by_camera;
			qcom,sw_vfloat_over_protect_enable;
			qcom,vbatt_pdqc_to_5v_thr = <0x1144>;
			qcom,vbatt_pdqc_to_9v_thr = <0x1068>;
			qcom,dual_charger_support = <0x00>;
			qcom,slave_pct = <0x1e>;
			qcom,slave_chg_enable_ma = <0x3e8>;
			qcom,slave_chg_disable_ma = <0x12c>;
			qcom,step1_time = <0x258>;
			qcom,step1_current_ma = <0xd48>;
			qcom,step2_time = <0x258>;
			qcom,step2_current_ma = <0xc1c>;
			qcom,step3_current_ma = <0xa8c>;
			status = "okay";
		};
	};

	fragment@12 {
		target = <0xffffffff>;

		__overlay__ {
			compatible = "mediatek,oplus-fastcharger";
			qcom,input_current_charger_ma = <0x7d0>;
			qcom,input_current_cdp_ma = <0x5dc>;
			qcom,input_current_usb_ma = <0x1f4>;
			qcom,input_current_led_ma = <0x4b0>;
			qcom,input_current_led_ma_forcmcc = <0x1f4>;
			qcom,input_current_camera_ma = <0x4b0>;
			qcom,input_current_calling_ma = <0x4b0>;
			qcom,input_current_led_ma_high = <0x3e8>;
			qcom,input_current_led_ma_warm = <0x5dc>;
			qcom,input_current_led_ma_normal = <0x7d0>;
			qcom,led_high_bat_decidegc = <0x172>;
			qcom,led_warm_bat_decidegc = <0x154>;
			qcom,iterm_disabled = <0x00>;
			qcom,iterm_ma = <0x12c>;
			qcom,recharge-mv = <0x73>;
			qcom,batt_capacity_mah = <0x1770>;
			qcom,removed_bat_decidegc = <0xbe>;
			qcom,cold_bat_decidegc = <0x14>;
			qcom,temp_cold_vfloat_mv = <0xf8c>;
			qcom,temp_cold_fastchg_current_ma = <0x15e>;
			qcom,little_cold_bat_decidegc = <0x00>;
			qcom,temp_little_cold_vfloat_mv = <0x1153>;
			qcom,temp_little_cold_fastchg_current_ma_high = <0x7d0>;
			qcom,temp_little_cold_fastchg_current_ma_low = <0x672>;
			qcom,temp_little_cold_fastchg_current_ma = <0x7d0>;
			qcom,temp_little_cold_usbchg_current_ma_high = <0x28a>;
			qcom,temp_little_cold_usbchg_current_ma_low = <0x28a>;
			qcom,temp_little_cold_usbchg_current_ma = <0x28a>;
			qcom,cool_bat_decidegc = <0x32>;
			qcom,temp_cool_vfloat_mv = <0x1153>;
			qcom,temp_cool_fastchg_current_ma_high = <0xabe>;
			qcom,temp_cool_fastchg_current_ma_low = <0xabe>;
			qcom,temp_cool_usbchg_current_ma_high = <0x28a>;
			qcom,temp_cool_usbchg_current_ma_low = <0x226>;
			qcom,little_cool_bat_decidegc = <0x78>;
			qcom,temp_little_cool_vfloat_mv = <0x1153>;
			qcom,temp_little_cool_fastchg_current_ma = <0xabe>;
			qcom,temp_little_cool_fastchg_current_ma_high = <0xd48>;
			qcom,temp_little_cool_usbchg_current_ma = <0x226>;
			qcom,normal_bat_decidegc = <0xa0>;
			qcom,temp_normal_fastchg_current_ma = <0x898>;
			qcom,temp_normal_usbchg_current_ma = <0x226>;
			qcom,temp_normal_vfloat_mv = <0x1153>;
			qcom,warm_bat_decidegc = <0x1c2>;
			qcom,temp_warm_vfloat_mv = <0x1022>;
			qcom,temp_warm_fastchg_current_ma = <0x672>;
			qcom,temp_warm_usbchg_current_ma = <0x226>;
			qcom,temp_warm_fastchg_current_ma_led_on = <0x1f4>;
			qcom,hot_bat_decidegc = <0x212>;
			qcom,non_standard_vfloat_mv = <0xf8c>;
			qcom,non_standard_fastchg_current_ma = <0x200>;
			qcom,short_c_bat_cv_mv = <0x10ea>;
			qcom,short_c_bat_vfloat_mv = <0xed8>;
			qcom,short_c_bat_fastchg_current_ma = <0x200>;
			qcom,short_c_bat_vfloat_sw_limit = <0xea6>;
			qcom,cold_vfloat_sw_limit = <0xf5a>;
			qcom,little_cold_vfloat_sw_limit = <0x111c>;
			qcom,cool_vfloat_sw_limit = <0x111c>;
			qcom,little_cool_vfloat_sw_limit = <0x111c>;
			qcom,normal_vfloat_sw_limit = <0x111c>;
			qcom,warm_vfloat_sw_limit = <0xff0>;
			qcom,non_standard_vfloat_sw_limit = <0xf5a>;
			qcom,max_chg_time_sec = <0x149a0>;
			qcom,charger_hv_thr = <0x2648>;
			qcom,charger_recv_thr = <0x2648>;
			qcom,charger_lv_thr = <0xd48>;
			qcom,vbatt_full_thr = <0x1130>;
			qcom,vbatt_hv_thr = <0x11c6>;
			qcom,vfloat_step_mv = <0x0a>;
			qcom,non_standard_vfloat_over_sw_limit = <0xfa0>;
			qcom,cold_vfloat_over_sw_limit = <0xfa0>;
			qcom,little_cold_vfloat_over_sw_limit = <0x1162>;
			qcom,cool_vfloat_over_sw_limit = <0x1162>;
			qcom,little_cool_vfloat_over_sw_limit = <0x1162>;
			qcom,normal_vfloat_over_sw_limit = <0x1162>;
			qcom,warm_vfloat_over_sw_limit = <0x1036>;
			qcom,vbatt_power_off = <0xce4>;
			qcom,vbatt_soc_1 = <0xd52>;
			qcom,vooc_project = <0x00>;
			qcom,vbatt_num = <0x01>;
			qcom,normal_vterm_hw_inc = <0x96>;
			qcom,non_normal_vterm_hw_inc = <0x0a>;
			qcom,ff1_normal_fastchg_ma = <0x440>;
			qcom,ffc2_normal_fastchg_ma = <0x30c>;
			qcom,ffc2_temp_warm_decidegc = <0x15e>;
			qcom,ffc2_warm_fastchg_ma = <0x348>;
			qcom,ffc2_temp_high_decidegc = <0x190>;
			qcom,ffc2_temp_low_decidegc = <0x78>;
			qcom,ff1_exit_step_ma = <0x1e8>;
			qcom,ff1_warm_exit_step_ma = <0x1a2>;
			qcom,ffc2_exit_step_ma = <0xb4>;
			qcom,ffc2_warm_exit_step_ma = <0xaa>;
			qcom,ffc_normal_vfloat_sw_limit = <0x114e>;
			qcom,ffc_temp_normal_vfloat_mv = <0x1194>;
			qcom,ffc_normal_vfloat_over_sw_limit = <0x1194>;
			qcom,default_iterm_ma = <0x12c>;
			qcom,default_temp_normal_fastchg_current_ma = <0x898>;
			qcom,default_normal_vfloat_sw_limit = <0x111c>;
			qcom,default_temp_normal_vfloat_mv = <0x1153>;
			qcom,default_normal_vfloat_over_sw_limit = <0x1162>;
			qcom,iterm_ma_2nd = <0x12c>;
			qcom,recharge-mv_2nd = <0x79>;
			qcom,temp_little_cold_vfloat_mv_2nd = <0x1127>;
			qcom,temp_cool_vfloat_mv_2nd = <0x1127>;
			qcom,temp_little_cool_vfloat_mv_2nd = <0x1127>;
			qcom,temp_normal_vfloat_mv_2nd = <0x1127>;
			qcom,little_cold_vfloat_over_sw_limit_2nd = <0x112b>;
			qcom,cool_vfloat_over_sw_limit_2nd = <0x112b>;
			qcom,little_cool_vfloat_over_sw_limit_2nd = <0x112b>;
			qcom,normal_vfloat_over_sw_limit_2nd = <0x112b>;
			qcom,default_iterm_ma_2nd = <0x12c>;
			qcom,default_temp_normal_vfloat_mv_2nd = <0x1127>;
			qcom,default_normal_vfloat_over_sw_limit_2nd = <0x112b>;
			qcom,check_batt_full_by_sw;
			qcom,chg_ctrl_by_calling;
			qcom,chg_ctrl_by_lcd;
			qcom,chg_ctrl_by_camera;
			qcom,sw_vfloat_over_protect_enable;
			qcom,vbatt_pdqc_to_5v_thr = <0x1144>;
			status = "okay";
		};
	};

	fragment@13 {
		target = <0xffffffff>;

		__overlay__ {
			#address-cells = <0x01>;
			#size-cells = <0x00>;
			status = "okay";

			finger_spi@0 {
				compatible = "mediatek,fingerspi-fp";
				reg = <0x00>;
				spi-max-frequency = <0x7a1200>;
				netlink-event = <0x1e>;
				spi-id = <0x01>;
				spi-irq = <0x05>;
				spi-reg = <0x11015000>;
				spi-avdd-gpio = <0x9e>;
				status = "okay";
			};
		};
	};

	fragment@14 {
		target = <0xffffffff>;

		__overlay__ {
			pinctrl-names = "default\0rst-low\0rst-high\0irq-init\0power_high\0power_low";
			pinctrl-0 = <0x04>;
			pinctrl-1 = <0x05>;
			pinctrl-2 = <0x06>;
			pinctrl-3 = <0x07>;
			pinctrl-4 = <0x08>;
			pinctrl-5 = <0x09>;
			status = "okay";
		};
	};

	fragment@15 {
		target = <0xffffffff>;

		__overlay__ {

			silfpdefault {
				phandle = <0x04>;
			};

			state_reset_low {
				phandle = <0x05>;

				pins_cmd_dat {
					pinmux = <0x400>;
					slew-rate = <0x01>;
					output-low;
				};
			};

			state_reset_high {
				phandle = <0x06>;

				pins_cmd_dat {
					pinmux = <0x400>;
					slew-rate = <0x01>;
					output-high;
				};
			};

			fp_eint@5 {
				phandle = <0x07>;

				pins_cmd_dat {
					pinmux = <0x500>;
					slew-rate = <0x00>;
					bias-disable;
				};
			};

			state_power_high {
				phandle = <0x08>;

				pins_cmd_dat {
					pinmux = <0x9e00>;
					slew-rate = <0x01>;
					output-high;
				};
			};

			state_power_low {
				phandle = <0x09>;

				pins_cmd_dat {
					pinmux = <0x9e00>;
					slew-rate = <0x01>;
					output-low;
				};
			};
		};
	};

	fragment@16 {
		target = <0xffffffff>;

		__overlay__ {

			gpio_id0_up {
				phandle = <0x0a>;

				pins_cmd_dat {
					pinmux = <0x2600>;
					slew-rate = <0x00>;
					bias-pull-up;
					input-enable;
				};
			};

			gpio_id0_down {
				phandle = <0x0b>;

				pins_cmd_dat {
					pinmux = <0x2600>;
					slew-rate = <0x00>;
					bias-pull-down;
					input-enable;
				};
			};
		};
	};

	fragment@17 {
		target = <0xffffffff>;

		__overlay__ {
			compatible = "oplus,fp_common";
			oplus,fp_gpio_num = <0x01>;
			oplus,fp_gpio_0 = <0xffffffff 0x26 0x00>;
			pinctrl-names = "gpio_id0_up\0gpio_id0_down";
			pinctrl-0 = <0x0a>;
			pinctrl-1 = <0x0b>;

			egis_520 {
				oplus,fp-id = <0x01>;
				vendor-chip = <0x12>;
				eng-menu = "-1,-1";
				chip-name = "E_520";
			};

			silead_6150 {
				oplus,fp-id = <0x00>;
				vendor-chip = <0x15>;
				eng-menu = "-1,-1";
				chip-name = "S_gsl6150";
			};
		};
	};

	fragment@18 {
		target = <0xffffffff>;

		__overlay__ {

			ctp_novatek_spi_mode {
				phandle = <0x0c>;

				pins_cmd_dat {
					pinmux = <0x1c02 0x1a02 0x1b02 0x1902>;
					drive-strength = <0x04>;
				};
			};
		};
	};

	fragment@19 {
		target = <0xffffffff>;

		__overlay__ {
			#address-cells = <0x01>;
			#size-cells = <0x00>;

			touchscreen@0 {
				compatible = "oppo,tp_noflash";
				reg = <0x00>;
				chip-name = "OPPO_TP_NOFLASH";
				status = "ok";
				spi-max-frequency = <0x927c00>;
				interrupt-parent = <0xffffffff>;
				interrupts = <0x01 0x02 0x01 0x00>;
				irq-gpio = <0xffffffff 0x01 0x2002>;
				reset-gpio = <0xffffffff 0x17 0x00>;
				platform_support_project = <0x4d1d>;
				platform_support_project_dir = <0x4d1d>;
				platform_support_project_commandline = "default_commandline";
				touchpanel,max-num-support = <0x0a>;
				touchpanel,tx-rx-num = <0x12 0x20>;
				touchpanel,panel-coords = <0x2d0 0x640>;
				touchpanel,display-coords = <0x2d0 0x640>;
				touchpanel,touchmajor-limit = <0x00 0x36>;
				pinctrl-names = "default";
				pinctrl-0 = <0x0c>;
				incell_screen;
				irq_need_dev_resume_ok;
				fw_edge_limit_support;
				black_gesture_support;
				charger_pump_support;
				headset_pump_support;
				esd_handle_support;
				black_gesture_test_support;
				game_switch_support;
				noflash_support;
				lcd_trigger_load_tp_fw_support;
				smart_gesture_support;
				pressure_report_support;
				fw_update_app_support;
				touchpanel,button-type = <0x04>;
				fw_update_in_probe_with_headfile;
			};
		};
	};

	fragment@20 {
		target = <0xffffffff>;

		__overlay__ {
			accdet-mic-vol = <0x07>;
			headset-mode-setting = <0x500 0x500 0x01 0x1f0 0x800 0x800 0x20 0x44>;
			accdet-plugout-debounce = <0x01>;
			accdet-mic-mode = <0x01>;
			headset-eint-level-pol = <0x08>;
			headset-three-key-threshold = <0x00 0x50 0xdc 0x190>;
			headset-three-key-threshold-CDD = <0x00 0x79 0xc0 0x258>;
			headset-four-key-threshold = <0x00 0x3a 0x79 0xc0 0x190>;
			status = "okay";
		};
	};

	fragment@21 {
		target = <0xffffffff>;

		__overlay__ {
			mt6370,intr_gpio_num = <0x14>;
			mt6370,intr_gpio = <0xffffffff 0x14 0x00>;
		};
	};

	fragment@22 {
		target = <0xffffffff>;

		__overlay__ {
			mt6370pd,intr_gpio_num = <0x29>;
			mt6370pd,intr_gpio = <0xffffffff 0x29 0x00>;
		};
	};

	fragment@23 {
		target = <0xffffffff>;

		__overlay__ {

			consys_default {
				phandle = <0x0d>;
			};

			gpslna@0 {
				phandle = <0x0e>;

				pins_cmd_dat {
					pinmux = <0x3500>;
					slew-rate = <0x00>;
					bias-disable;
					output-low;
				};
			};

			gpslna@1 {
				phandle = <0x0f>;

				pins_cmd_dat {
					pinmux = <0x3500>;
					slew-rate = <0x01>;
					output-high;
				};
			};

			gpslna@2 {
				phandle = <0x10>;

				pins_cmd_dat {
					pinmux = <0x3500>;
					slew-rate = <0x01>;
					output-low;
				};
			};
		};
	};

	fragment@24 {
		target = <0xffffffff>;

		__overlay__ {
			pinctrl-names = "default\0gps_lna_state_init\0gps_lna_state_oh\0gps_lna_state_ol";
			pinctrl-0 = <0x0d>;
			pinctrl-1 = <0x0e>;
			pinctrl-2 = <0x0f>;
			pinctrl-3 = <0x10>;
			status = "okay";
		};
	};

	fragment@25 {
		target = <0xffffffff>;

		__overlay__ {
			pinctrl-names = "irtx_gpio_led_default\0irtx_gpio_led_set";
			pinctrl-0 = <0x11>;
			pinctrl-1 = <0x12>;
			status = "okay";
		};
	};

	fragment@26 {
		target = <0xffffffff>;

		__overlay__ {

			irtx_gpio_led_def@gpio12 {
				phandle = <0x11>;

				pins_cmd_dat {
					pinmux = <0xc00>;
					slew-rate = <0x01>;
					bias-disable;
					output-low;
					input-schmitt-enable = <0x00>;
				};
			};

			irtx_gpio_led_set@gpio12 {
				phandle = <0x12>;

				pins_cmd_dat {
					pinmux = <0xc01>;
					slew-rate = <0x01>;
					output-high;
				};
			};
		};
	};

	fragment@27 {
		target = <0xffffffff>;

		__overlay__ {

			lcm_rst_out1_gpio {
				phandle = <0x66>;

				pins_cmd_dat {
					pinmux = <0x2d00>;
					slew-rate = <0x01>;
					output-high;
				};
			};

			lcm_rst_out0_gpio {
				phandle = <0x67>;

				pins_cmd_dat {
					pinmux = <0x2d00>;
					slew-rate = <0x01>;
					output-low;
				};
			};

			lcm_dsi_te {
				phandle = <0x68>;

				pins_cmd_dat {
					pinmux = <0x2c01>;
				};
			};
		};
	};

	fragment@28 {
		target = <0xffffffff>;

		__overlay__ {
			pinctrl-names = "lcm_rst_out0_gpio\0lcm_rst_out1_gpio\0lcd_bias_enp0_gpio\0lcd_bias_enp1_gpio\0lcd_bias_enn0_gpio\0lcd_bias_enn1_gpio\0lcd_vddio18_en0_gpio\0lcd_vddio18_en1_gpio";
			pinctrl-0 = <0x13>;
			pinctrl-1 = <0x14>;
			pinctrl-2 = <0x15>;
			pinctrl-3 = <0x16>;
			pinctrl-4 = <0x17>;
			pinctrl-5 = <0x18>;
			status = "okay";
			oplus_display_elevenbits_support;
			oplus_display_cabc_cmdq_support;
			oplus_display_panelnum_support;
		};
	};

	fragment@29 {
		target = <0xffffffff>;

		__overlay__ {

			lcm_rst_out0_gpio {
				phandle = <0x13>;

				pins_cmd_dat {
					pinmux = <0x2d00>;
					slew-rate = <0x01>;
					output-low;
				};
			};

			lcm_rst_out1_gpio {
				phandle = <0x14>;

				pins_cmd_dat {
					pinmux = <0x2d00>;
					slew-rate = <0x01>;
					output-high;
				};
			};

			lcd_bias_enp0_gpio {
				phandle = <0x15>;

				pins_cmd_dat {
					pinmux = <0xa900>;
					slew-rate = <0x01>;
					output-low;
				};
			};

			lcd_bias_enp1_gpio {
				phandle = <0x16>;

				pins_cmd_dat {
					pinmux = <0xa900>;
					slew-rate = <0x01>;
					output-high;
				};
			};

			lcd_bias_enn0_gpio {
				phandle = <0x17>;

				pins_cmd_dat {
					pinmux = <0xa500>;
					slew-rate = <0x01>;
					output-low;
				};
			};

			lcd_bias_enn1_gpio {
				phandle = <0x18>;

				pins_cmd_dat {
					pinmux = <0xa500>;
					slew-rate = <0x01>;
					output-high;
				};
			};
		};
	};

	fragment@30 {
		target = <0xffffffff>;

		__overlay__ {
			mtk_pull_down_stay_enable = <0x01>;
		};
	};

	fragment@31 {
		target = <0xffffffff>;

		__overlay__ {
			io-channels = <0xffffffff 0x02>;
			io-channel-names = "batteryID-channel";
		};
	};

	fragment@32 {
		target = <0xffffffff>;

		__overlay__ {

			rt-swchg@53 {
				compatible = "richtek,swchg";
				reg = <0x53>;
				status = "okay";
				rt,intr_gpio_num = <0x07>;
				rt,intr_gpio = <0xffffffff 0x07 0x00>;

				rt9471 {
					charger_name = "primary_chg";
					chg_alias_name = "rt9471_chg";
					rm-slave-addr = [53];
					rm-name = "rt9471";
					interrupt-names = "wdt\0chg_mivr\0vbus_gd\0bc12_done\0detach\0vac_ov\0otg_fault\0chg_rdy\0chg_done";
					ichg = <0xf4240>;
					aicr = <0x7a120>;
					mivr = <0x432380>;
					cv = <0x426030>;
					ieoc = <0x30d40>;
					safe-tmr = <0x0a>;
					wdt = <0x28>;
					mivr-track = <0x00>;
					en-te;
					en-qon-rst;
				};
			};
		};
	};

	fragment@33 {
		target = <0xffffffff>;

		__overlay__ {
			ac_charger_input_current = <0x1e8480>;
			ac_charger_current = <0x1e8480>;
		};
	};

	fragment@34 {
		target = <0xffffffff>;

		__overlay__ {
			compatible = "mediatek,usb_iddig_bi_eint";
			interrupt-parent = <0xffffffff>;
			interrupts = <0x93 0x08 0x93 0x00>;
			pinctrl-names = "otg_iddg_high\0otg_gpio_low";
			pinctrl-0 = <0x19>;
			pinctrl-1 = <0x1a>;
			status = "okay";
		};
	};

	fragment@35 {
		target = <0xffffffff>;

		__overlay__ {

			otg_iddg_high {
				phandle = <0x19>;

				pins_cmd_dat {
					pinmux = <0x2901>;
				};
			};

			otg_gpio_low {
				phandle = <0x1a>;

				pins_cmd_dat {
					pinmux = <0x2900>;
					slew-rate = <0x01>;
					input-low;
				};
			};
		};
	};

	fragment@36 {
		target = <0xffffffff>;

		__overlay__ {

			adc_channel@ {
				compatible = "mediatek,adc_channel";
				mediatek,temperature0 = <0x00>;
				mediatek,temperature1 = <0x01>;
				mediatek,adc_fdd_rf_params_dynamic_custom_ch = <0x02>;
				status = "okay";
			};
		};
	};

	fragment@37 {
		target = <0xffffffff>;

		__overlay__ {
			io-channels = <0xffffffff 0x02>;
		};
	};

	fragment@38 {
		target = <0xffffffff>;

		__overlay__ {
			mediatek,clkbuf-quantity = <0x07>;
			mediatek,clkbuf-config = <0x02 0x01 0x01 0x02 0x00 0x00 0x00>;
			mediatek,clkbuf-driving-current = <0x01 0x01 0x01 0x01 0x01 0x01 0x01>;
			status = "okay";
		};
	};

	fragment@39 {
		target = <0xffffffff>;

		__overlay__ {
			#address-cells = <0x01>;
			#size-cells = <0x00>;
			clock-frequency = <0x61a80>;
			mediatek,use-open-drain;

			cap_touch@5d {
				compatible = "mediatek,cap_touch";
				reg = <0x5d>;
				status = "okay";
				phandle = <0x69>;
			};
		};
	};

	fragment@40 {
		target = <0xffffffff>;

		__overlay__ {
			#address-cells = <0x01>;
			#size-cells = <0x00>;
			clock-frequency = <0x61a80>;
			mediatek,use-open-drain;
		};
	};

	fragment@41 {
		target = <0xffffffff>;

		__overlay__ {
			#address-cells = <0x01>;
			#size-cells = <0x00>;
			clock-frequency = <0x61a80>;
			mediatek,use-open-drain;

			camera_main@6c {
				compatible = "mediatek,camera_main";
				reg = <0x6c>;
				status = "okay";
				phandle = <0x6a>;
			};

			camera_main_eeprom@50 {
				compatible = "mediatek,camera_main_eeprom";
				reg = <0x50>;
				status = "okay";
				phandle = <0x6b>;
			};

			camera_main_af@18 {
				compatible = "mediatek,camera_main_af";
				reg = <0x18>;
				status = "okay";
				phandle = <0x6c>;
			};

			ccu_sensor_i2c_2_hw@11 {
				compatible = "mediatek,ccu_sensor_i2c_2_hw";
				reg = <0x11>;
				status = "okay";
				phandle = <0x6d>;
			};
		};
	};

	fragment@42 {
		target = <0xffffffff>;

		__overlay__ {
			#address-cells = <0x01>;
			#size-cells = <0x00>;
			clock-frequency = <0x61a80>;
			mediatek,use-open-drain;

			nfc@08 {
				compatible = "mediatek,nfc";
				reg = <0x08>;
				status = "okay";
				phandle = <0x6e>;
			};
		};
	};

	fragment@43 {
		target = <0xffffffff>;

		__overlay__ {
			#address-cells = <0x01>;
			#size-cells = <0x00>;
			clock-frequency = <0x61a80>;
			mediatek,use-open-drain;

			camera_main_three@2e {
				compatible = "mediatek,camera_main_three";
				reg = <0x2e>;
				status = "okay";
				phandle = <0x6f>;
			};

			camera_sub_two@7a {
				compatible = "mediatek,camera_sub_two";
				reg = <0x7a>;
				status = "okay";
				phandle = <0x70>;
			};

			camera_main_two@6c {
				compatible = "mediatek,camera_main_two";
				reg = <0x6c>;
				status = "okay";
				phandle = <0x71>;
			};

			camera_sub@6e {
				compatible = "mediatek,camera_sub";
				reg = <0x6e>;
				status = "okay";
				phandle = <0x72>;
			};

			camera_sub_eeprom@52 {
				compatible = "mediatek,camera_sub_eeprom";
				reg = <0x52>;
				status = "okay";
				phandle = <0x73>;
			};

			camera_main_two_eeprom@54 {
				compatible = "mediatek,camera_main_two_eeprom";
				reg = <0x54>;
				status = "okay";
				phandle = <0x74>;
			};

			ccu_sensor_i2c_4_hw@12 {
				compatible = "mediatek,ccu_sensor_i2c_4_hw";
				reg = <0x12>;
				status = "okay";
				phandle = <0x75>;
			};

			camera_sub_two_eeprom@a4 {
				compatible = "mediatek,camera_sub_two_eeprom";
				reg = <0xa4>;
				status = "okay";
				phandle = <0x76>;
			};
		};
	};

	fragment@44 {
		target = <0xffffffff>;

		__overlay__ {
			#address-cells = <0x01>;
			#size-cells = <0x00>;
			clock-frequency = <0x33e140>;
			mediatek,use-push-pull;

			subpmic_pmu@34 {
				compatible = "mediatek,subpmic_pmu";
				reg = <0x34>;
				status = "okay";
				phandle = <0x77>;
			};

			usb_type_c@4e {
				compatible = "mediatek,usb_type_c";
				reg = <0x4e>;
				status = "okay";
				phandle = <0x78>;
			};
		};
	};

	fragment@45 {
		target = <0xffffffff>;

		__overlay__ {
			#address-cells = <0x01>;
			#size-cells = <0x00>;
			clock-frequency = <0x61a80>;
			mediatek,use-open-drain;

			strobe_main@63 {
				compatible = "mediatek,strobe_main";
				reg = <0x63>;
				status = "okay";
				phandle = <0x79>;
			};
		};
	};

	fragment@46 {
		target = <0xffffffff>;

		__overlay__ {
			#address-cells = <0x01>;
			#size-cells = <0x00>;
			clock-frequency = <0x61a80>;
			mediatek,use-open-drain;

			speaker_amp@34 {
				compatible = "mediatek,speaker_amp";
				reg = <0x34>;
				status = "okay";
				phandle = <0x7a>;
			};

			slave_charger@4b {
				compatible = "mediatek,slave_charger";
				reg = <0x4b>;
				status = "okay";
				phandle = <0x7b>;
			};
		};
	};

	fragment@47 {
		target = <0xffffffff>;

		__overlay__ {
			#address-cells = <0x01>;
			#size-cells = <0x00>;
			clock-frequency = <0x61a80>;
			mediatek,use-open-drain;
		};
	};

	fragment@48 {
		target = <0xffffffff>;

		__overlay__ {
			GPIO_FDD_BAND_SUPPORT_DETECT_5TH_PIN = <0xffffffff 0x21 0x00>;
			GPIO_FDD_BAND_SUPPORT_DETECT_1ST_PIN = <0xffffffff 0x28 0x00>;
			GPIO_FDD_BAND_SUPPORT_DETECT_3RD_PIN = <0xffffffff 0x2a 0x00>;
			GPIO_SIM2_HOT_PLUG = <0xffffffff 0x2e 0x00>;
			GPIO_SIM1_HOT_PLUG = <0xffffffff 0x2f 0x00>;
			GPIO_FDD_BAND_SUPPORT_DETECT_2ND_PIN = <0xffffffff 0x5c 0x00>;
			GPIO_SIM2_SIO = <0xffffffff 0x9b 0x00>;
			GPIO_SIM2_SRST = <0xffffffff 0x9c 0x00>;
			GPIO_SIM2_SCLK = <0xffffffff 0x9d 0x00>;
			GPIO_SIM1_SCLK = <0xffffffff 0xac 0x00>;
			GPIO_SIM1_SRST = <0xffffffff 0xad 0x00>;
			GPIO_SIM1_SIO = <0xffffffff 0xae 0x00>;
			GPIO_FDD_BAND_SUPPORT_DETECT_4TH_PIN = <0xffffffff 0xb3 0x00>;
		};
	};

	fragment@49 {
		target = <0xffffffff>;

		__overlay__ {
			gpio_init_default = <0x00 0x00 0x00 0x00 0x01 0x01 0x01 0x01 0x00 0x00 0x00 0x01 0x01 0x01 0x02 0x00 0x00 0x00 0x01 0x00 0x01 0x03 0x00 0x00 0x00 0x01 0x00 0x01 0x04 0x00 0x01 0x00 0x01 0x00 0x00 0x05 0x00 0x00 0x00 0x01 0x00 0x00 0x06 0x00 0x00 0x00 0x01 0x00 0x00 0x07 0x00 0x00 0x00 0x01 0x00 0x00 0x08 0x07 0x00 0x00 0x01 0x00 0x00 0x09 0x00 0x00 0x00 0x01 0x00 0x00 0x0a 0x00 0x00 0x00 0x01 0x01 0x00 0x0b 0x01 0x00 0x00 0x01 0x00 0x00 0x0c 0x02 0x00 0x00 0x01 0x00 0x00 0x0d 0x02 0x00 0x00 0x01 0x00 0x00 0x0e 0x02 0x01 0x00 0x00 0x00 0x00 0x0f 0x02 0x01 0x00 0x00 0x00 0x00 0x10 0x02 0x01 0x00 0x00 0x00 0x00 0x11 0x00 0x00 0x00 0x01 0x00 0x01 0x12 0x00 0x00 0x00 0x01 0x01 0x01 0x13 0x00 0x01 0x00 0x01 0x00 0x01 0x14 0x00 0x00 0x00 0x01 0x01 0x01 0x15 0x00 0x01 0x00 0x00 0x00 0x00 0x16 0x05 0x00 0x00 0x01 0x00 0x00 0x17 0x00 0x01 0x01 0x00 0x00 0x00 0x18 0x05 0x00 0x00 0x01 0x00 0x00 0x19 0x02 0x01 0x01 0x00 0x00 0x00 0x1a 0x02 0x01 0x00 0x01 0x00 0x00 0x1b 0x02 0x01 0x00 0x00 0x00 0x00 0x1c 0x02 0x00 0x00 0x01 0x00 0x00 0x1d 0x00 0x01 0x00 0x00 0x00 0x00 0x1e 0x00 0x01 0x00 0x00 0x00 0x00 0x1f 0x00 0x00 0x00 0x01 0x00 0x00 0x20 0x07 0x01 0x00 0x00 0x00 0x00 0x21 0x00 0x00 0x00 0x01 0x00 0x00 0x22 0x07 0x00 0x00 0x01 0x00 0x00 0x23 0x07 0x00 0x00 0x01 0x00 0x00 0x24 0x00 0x00 0x00 0x00 0x00 0x00 0x25 0x02 0x01 0x00 0x00 0x00 0x00 0x26 0x00 0x00 0x00 0x01 0x01 0x00 0x27 0x00 0x00 0x00 0x01 0x01 0x01 0x28 0x00 0x00 0x00 0x01 0x00 0x00 0x29 0x00 0x00 0x00 0x01 0x01 0x01 0x2a 0x00 0x00 0x00 0x01 0x00 0x01 0x2b 0x01 0x01 0x00 0x00 0x00 0x00 0x2c 0x01 0x00 0x00 0x01 0x00 0x00 0x2d 0x00 0x01 0x00 0x00 0x00 0x00 0x2e 0x01 0x00 0x00 0x01 0x01 0x00 0x2f 0x01 0x00 0x00 0x01 0x01 0x00 0x30 0x01 0x00 0x00 0x01 0x01 0x01 0x31 0x01 0x00 0x00 0x01 0x01 0x01 0x32 0x01 0x00 0x00 0x01 0x01 0x01 0x33 0x01 0x00 0x00 0x01 0x01 0x01 0x34 0x01 0x00 0x00 0x01 0x00 0x00 0x35 0x00 0x01 0x00 0x00 0x00 0x00 0x36 0x00 0x01 0x00 0x01 0x00 0x00 0x37 0x01 0x00 0x00 0x01 0x00 0x00 0x38 0x01 0x00 0x00 0x01 0x00 0x00 0x39 0x00 0x00 0x00 0x00 0x00 0x00 0x3a 0x00 0x00 0x00 0x01 0x00 0x00 0x3b 0x01 0x00 0x00 0x01 0x00 0x00 0x3c 0x01 0x00 0x00 0x01 0x00 0x00 0x3d 0x01 0x00 0x00 0x01 0x00 0x00 0x3e 0x01 0x00 0x00 0x01 0x00 0x00 0x3f 0x01 0x00 0x00 0x01 0x00 0x00 0x40 0x01 0x00 0x00 0x01 0x00 0x00 0x41 0x01 0x00 0x00 0x01 0x00 0x00 0x42 0x01 0x00 0x00 0x01 0x00 0x00 0x43 0x01 0x00 0x00 0x01 0x00 0x00 0x44 0x01 0x00 0x00 0x01 0x00 0x00 0x45 0x01 0x00 0x00 0x01 0x00 0x00 0x46 0x01 0x00 0x00 0x01 0x00 0x00 0x47 0x01 0x00 0x00 0x01 0x00 0x00 0x48 0x01 0x00 0x00 0x01 0x00 0x00 0x49 0x01 0x00 0x00 0x01 0x00 0x00 0x4a 0x01 0x00 0x00 0x01 0x00 0x00 0x4b 0x01 0x00 0x00 0x01 0x00 0x00 0x4c 0x01 0x00 0x00 0x01 0x00 0x00 0x4d 0x01 0x00 0x00 0x01 0x00 0x00 0x4e 0x01 0x00 0x00 0x01 0x00 0x00 0x4f 0x00 0x00 0x00 0x01 0x00 0x00 0x50 0x00 0x00 0x00 0x01 0x00 0x00 0x51 0x02 0x00 0x00 0x01 0x01 0x01 0x52 0x01 0x00 0x00 0x01 0x01 0x01 0x53 0x01 0x00 0x00 0x01 0x01 0x01 0x54 0x02 0x00 0x00 0x01 0x01 0x01 0x55 0x02 0x00 0x00 0x01 0x00 0x00 0x56 0x02 0x01 0x00 0x00 0x00 0x00 0x57 0x02 0x01 0x00 0x00 0x00 0x00 0x58 0x02 0x01 0x00 0x00 0x00 0x00 0x59 0x01 0x00 0x00 0x01 0x01 0x01 0x5a 0x01 0x00 0x00 0x01 0x01 0x01 0x5b 0x00 0x00 0x00 0x00 0x00 0x00 0x5c 0x00 0x00 0x00 0x01 0x00 0x00 0x5d 0x01 0x00 0x00 0x01 0x01 0x00 0x5e 0x01 0x00 0x00 0x01 0x01 0x00 0x5f 0x01 0x00 0x00 0x01 0x01 0x00 0x60 0x01 0x01 0x00 0x00 0x00 0x00 0x61 0x00 0x01 0x00 0x00 0x00 0x00 0x62 0x00 0x01 0x00 0x00 0x00 0x00 0x63 0x01 0x01 0x00 0x00 0x00 0x00 0x64 0x01 0x01 0x00 0x00 0x00 0x00 0x65 0x00 0x01 0x00 0x00 0x00 0x00 0x66 0x00 0x01 0x00 0x00 0x00 0x00 0x67 0x01 0x00 0x00 0x01 0x01 0x01 0x68 0x01 0x00 0x00 0x01 0x01 0x01 0x69 0x01 0x00 0x00 0x01 0x01 0x01 0x6a 0x01 0x00 0x00 0x01 0x01 0x01 0x6b 0x00 0x01 0x00 0x00 0x00 0x00 0x6c 0x00 0x00 0x00 0x00 0x00 0x00 0x6d 0x00 0x01 0x00 0x00 0x00 0x00 0x6e 0x00 0x01 0x00 0x00 0x00 0x00 0x6f 0x01 0x01 0x00 0x00 0x00 0x00 0x70 0x00 0x01 0x00 0x00 0x00 0x00 0x71 0x00 0x00 0x00 0x01 0x00 0x00 0x72 0x00 0x00 0x00 0x01 0x00 0x00 0x73 0x00 0x00 0x00 0x01 0x00 0x00 0x74 0x00 0x00 0x00 0x01 0x00 0x00 0x75 0x00 0x00 0x00 0x01 0x00 0x00 0x76 0x00 0x00 0x00 0x01 0x00 0x00 0x77 0x00 0x00 0x00 0x01 0x00 0x00 0x78 0x00 0x00 0x00 0x01 0x00 0x00 0x79 0x00 0x00 0x00 0x01 0x00 0x00 0x86 0x01 0x00 0x00 0x01 0x00 0x01 0x87 0x01 0x01 0x00 0x00 0x00 0x00 0x88 0x01 0x01 0x00 0x00 0x00 0x00 0x89 0x01 0x01 0x00 0x00 0x00 0x00 0x8a 0x01 0x01 0x00 0x00 0x00 0x00 0x8b 0x01 0x01 0x00 0x00 0x00 0x00 0x8c 0x01 0x00 0x00 0x01 0x00 0x00 0x8d 0x01 0x00 0x00 0x01 0x00 0x00 0x8e 0x01 0x00 0x00 0x01 0x00 0x00 0x8f 0x01 0x00 0x00 0x01 0x00 0x00 0x90 0x01 0x00 0x00 0x01 0x00 0x00 0x91 0x01 0x01 0x00 0x00 0x00 0x00 0x92 0x01 0x01 0x00 0x00 0x00 0x00 0x93 0x01 0x01 0x00 0x00 0x00 0x00 0x94 0x01 0x01 0x00 0x00 0x00 0x00 0x95 0x01 0x01 0x00 0x00 0x00 0x00 0x96 0x04 0x00 0x00 0x01 0x01 0x00 0x97 0x04 0x01 0x00 0x00 0x00 0x00 0x98 0x00 0x01 0x00 0x00 0x00 0x00 0x99 0x00 0x01 0x00 0x00 0x00 0x00 0x9a 0x01 0x01 0x00 0x00 0x00 0x00 0x9b 0x01 0x00 0x00 0x01 0x01 0x00 0x9c 0x01 0x01 0x00 0x00 0x00 0x00 0x9d 0x01 0x01 0x00 0x00 0x00 0x00 0x9e 0x01 0x01 0x00 0x00 0x00 0x00 0x9f 0x00 0x00 0x00 0x01 0x00 0x00 0xa0 0x00 0x01 0x00 0x00 0x00 0x00 0xa1 0x01 0x00 0x00 0x01 0x01 0x01 0xa2 0x01 0x00 0x00 0x01 0x01 0x01 0xa3 0x01 0x00 0x00 0x01 0x01 0x01 0xa4 0x01 0x00 0x00 0x01 0x01 0x01 0xa5 0x00 0x01 0x00 0x00 0x00 0x00 0xa6 0x00 0x01 0x00 0x00 0x00 0x00 0xa7 0x01 0x00 0x00 0x01 0x00 0x00 0xa8 0x01 0x00 0x00 0x01 0x00 0x00 0xa9 0x00 0x01 0x00 0x00 0x00 0x00 0xaa 0x01 0x00 0x00 0x01 0x01 0x01 0xab 0x01 0x01 0x00 0x00 0x00 0x01 0xac 0x01 0x01 0x00 0x00 0x00 0x00 0xad 0x01 0x01 0x00 0x00 0x00 0x00 0xae 0x01 0x00 0x00 0x01 0x01 0x00 0xaf 0x01 0x00 0x00 0x01 0x01 0x01 0xb0 0x01 0x00 0x00 0x01 0x01 0x01 0xb2 0x00 0x01 0x00 0x00 0x00 0x00 0xb3 0x00 0x00 0x00 0x01 0x00 0x00 0xb4 0x00 0x00 0x00 0x01 0x00 0x00 0xb5 0x00 0x00 0x00 0x01 0x00 0x00 0xb6 0x00 0x00 0x00 0x01 0x00 0x00 0xb7 0x00 0x00 0x00 0x01 0x00 0x00 0xb8 0x00 0x00 0x00 0x01 0x00 0x00 0xb9 0x00 0x00 0x00 0x01 0x00 0x00 0xba 0x00 0x00 0x00 0x01 0x00 0x00>;
		};
	};

	fragment@50 {
		target = <0xffffffff>;

		__overlay__ {
			interrupt-parent = <0xffffffff>;
			interrupts = <0x00 0x08 0x00 0x00>;
			deb-gpios = <0xffffffff 0x00 0x00>;
			debounce = <0x7d000>;
			status = "okay";
		};
	};

	fragment@51 {
		target = <0xffffffff>;

		__overlay__ {
			interrupt-parent = <0xffffffff>;
			interrupts = <0x01 0x02 0x01 0x00>;
			status = "okay";
		};
	};

	fragment@52 {
		target = <0xffffffff>;

		__overlay__ {
			interrupt-parent = <0xffffffff>;
			interrupts = <0x05 0x01 0x05 0x00>;
			status = "okay";
		};
	};

	fragment@53 {
		target = <0xffffffff>;

		__overlay__ {
			interrupt-parent = <0xffffffff>;
			interrupts = <0x06 0x04 0x06 0x00>;
			status = "okay";
		};
	};

	fragment@54 {
		target = <0xffffffff>;

		__overlay__ {
			interrupt-parent = <0xffffffff>;
			interrupts = <0x14 0x02 0x14 0x00>;
			status = "okay";
		};
	};

	fragment@55 {
		target = <0xffffffff>;

		__overlay__ {
			interrupt-parent = <0xffffffff>;
			interrupts = <0x27 0x08 0x27 0x00>;
			status = "okay";
		};
	};

	fragment@56 {
		target = <0xffffffff>;

		__overlay__ {
			interrupt-parent = <0xffffffff>;
			interrupts = <0x2c 0x01 0x2c 0x01>;
			status = "okay";
		};
	};

	fragment@57 {
		target = <0xffffffff>;

		__overlay__ {
			interrupt-parent = <0xffffffff>;
			interrupts = <0x90 0x04 0xb4 0x00>;
			status = "okay";
		};
	};

	fragment@58 {
		target = <0xffffffff>;

		__overlay__ {
			compatible = "mediatek,md1_sim1_hot_plug_eint-eint";
			interrupts = <0x00 0x08>;
			debounce = <0x00 0x3e8>;
			dedicated = <0x00 0x00>;
			src_pin = <0x00 0x01>;
			sockettype = <0x00 0x00>;
			status = "okay";
		};
	};

	fragment@59 {
		target = <0xffffffff>;

		__overlay__ {
			compatible = "mediatek,md1_sim2_hot_plug_eint-eint";
			interrupts = <0x01 0x08>;
			debounce = <0x01 0x3e8>;
			dedicated = <0x01 0x00>;
			src_pin = <0x01 0x02>;
			sockettype = <0x01 0x00>;
			status = "okay";
		};
	};

	fragment@60 {
		target = <0xffffffff>;

		__overlay__ {
			regulator-name = "vcama1";
			regulator-default-on = <0x01>;
			status = "okay";
		};
	};

	fragment@61 {
		target = <0xffffffff>;

		__overlay__ {
			regulator-name = "vcama2";
			regulator-default-on = <0x01>;
			status = "okay";
		};
	};

	fragment@62 {
		target = <0xffffffff>;

		__overlay__ {
			regulator-name = "vsim1";
			regulator-default-on = <0x01>;
			status = "okay";
		};
	};

	fragment@63 {
		target = <0xffffffff>;

		__overlay__ {
			regulator-name = "vsim2";
			regulator-default-on = <0x01>;
			status = "okay";
		};
	};

	fragment@64 {
		target = <0xffffffff>;

		__overlay__ {
			regulator-name = "vcamd";
			regulator-default-on = <0x01>;
			status = "okay";
		};
	};

	fragment@65 {
		target = <0xffffffff>;

		__overlay__ {
			regulator-name = "vcamio";
			regulator-default-on = <0x01>;
			status = "okay";
		};
	};

	fragment@66 {
		target = <0xffffffff>;

		__overlay__ {
			regulator-name = "vldo28";
			regulator-default-on = <0x01>;
			status = "okay";
		};
	};

	fragment@67 {
		target = <0xffffffff>;

		__overlay__ {
			vcama-supply = <0xffffffff>;
			vcama_main2-supply = <0xffffffff>;
			vcama_sub-supply = <0xffffffff>;
			vcama_sub2-supply = <0xffffffff>;
			vcama_main3-supply = <0xffffffff>;
			vcamd_main2-supply = <0xffffffff>;
			vcamd_sub-supply = <0xffffffff>;
			vcamio-supply = <0xffffffff>;
			vcamio_sub-supply = <0xffffffff>;
			vcamio_main2-supply = <0xffffffff>;
			vcamio_sub2-supply = <0xffffffff>;
			vcamio_main3-supply = <0xffffffff>;
			vcamaf-supply = <0xffffffff>;
			vcamaf_sub-supply = <0xffffffff>;
			vcamaf_main2-supply = <0xffffffff>;
			status = "okay";
		};
	};

	fragment@68 {
		target = <0xffffffff>;

		__overlay__ {
			vtouch-supply = <0xffffffff>;
			status = "okay";
		};
	};

	fragment@69 {
		target = <0xffffffff>;

		__overlay__ {
			mediatek,kpd-key-debounce = <0x400>;
			mediatek,kpd-sw-pwrkey = <0x74>;
			mediatek,kpd-hw-pwrkey = <0x08>;
			mediatek,kpd-sw-rstkey = <0x73>;
			mediatek,kpd-hw-rstkey = <0x11>;
			mediatek,kpd-use-extend-type = <0x00>;
			mediatek,kpd-hw-map-num = <0x48>;
			mediatek,kpd-hw-init-map = <0x00 0x72 0x00 0x00 0x00 0x00 0x00 0x00 0x00 0x00 0x00 0x00 0x00 0x00 0x00 0x00 0x00 0x00 0x00 0x00 0x00 0x00 0x00 0x00 0x00 0x00 0x00 0x00 0x00 0x00 0x00 0x00 0x00 0x00 0x00 0x00 0x00 0x00 0x00 0x00 0x00 0x00 0x00 0x00 0x00 0x00 0x00 0x00 0x00 0x00 0x00 0x00 0x00 0x00 0x00 0x00 0x00 0x00 0x00 0x00 0x00 0x00 0x00 0x00 0x00 0x00 0x00 0x00 0x00 0x00 0x00 0x00>;
			mediatek,kpd-pwrkey-eint-gpio = <0x00>;
			mediatek,kpd-pwkey-gpio-din = <0x00>;
			mediatek,kpd-hw-dl-key0 = <0x11>;
			mediatek,kpd-hw-dl-key1 = <0x01>;
			mediatek,kpd-hw-recovery-key = <0x01>;
			mediatek,kpd-hw-factory-key = <0x11>;
			status = "okay";
		};
	};

	fragment@70 {
		target = <0xffffffff>;

		__overlay__ {

			camera0_mclk_2mA@gpio108 {
				phandle = <0x33>;

				pins_cmd_dat {
					pinmux = <0x6c01>;
					drive-strength = <0x02>;
				};
			};

			camera0_mclk_4mA@gpio108 {
				phandle = <0x34>;

				pins_cmd_dat {
					pinmux = <0x6c01>;
					drive-strength = <0x04>;
				};
			};

			camera0_mclk_6mA@gpio108 {
				phandle = <0x35>;

				pins_cmd_dat {
					pinmux = <0x6c01>;
					drive-strength = <0x06>;
				};
			};

			camera0_mclk_8mA@gpio108 {
				phandle = <0x36>;

				pins_cmd_dat {
					pinmux = <0x6c01>;
					drive-strength = <0x07>;
				};
			};

			camera0_mclk_gpio_mode@gpio108 {
				phandle = <0x32>;

				pins_cmd_dat {
					pinmux = <0x6c00>;
					drive-strength = <0x04>;
				};
			};

			camera1_mclk_2mA@gpio100 {
				phandle = <0x38>;

				pins_cmd_dat {
					pinmux = <0x6401>;
					drive-strength = <0x02>;
				};
			};

			camera1_mclk_4mA@gpio100 {
				phandle = <0x39>;

				pins_cmd_dat {
					pinmux = <0x6401>;
					drive-strength = <0x04>;
				};
			};

			camera1_mclk_6mA@gpio100 {
				phandle = <0x3a>;

				pins_cmd_dat {
					pinmux = <0x6401>;
					drive-strength = <0x06>;
				};
			};

			camera1_mclk_8mA@gpio100 {
				phandle = <0x3b>;

				pins_cmd_dat {
					pinmux = <0x6401>;
					drive-strength = <0x07>;
				};
			};

			camera1_mclk_gpio_mode@gpio100 {
				phandle = <0x37>;

				pins_cmd_dat {
					pinmux = <0x6400>;
					drive-strength = <0x04>;
				};
			};

			camera2_mclk_2mA@gpio111 {
				phandle = <0x3d>;

				pins_cmd_dat {
					pinmux = <0x6f01>;
					drive-strength = <0x02>;
				};
			};

			camera2_mclk_4mA@gpio111 {
				phandle = <0x3e>;

				pins_cmd_dat {
					pinmux = <0x6f01>;
					drive-strength = <0x04>;
				};
			};

			camera2_mclk_6mA@gpio111 {
				phandle = <0x3f>;

				pins_cmd_dat {
					pinmux = <0x6f01>;
					drive-strength = <0x06>;
				};
			};

			camera2_mclk_8mA@gpio111 {
				phandle = <0x40>;

				pins_cmd_dat {
					pinmux = <0x6f01>;
					drive-strength = <0x07>;
				};
			};

			camera2_mclk_gpio_mode@gpio111 {
				phandle = <0x3c>;

				pins_cmd_dat {
					pinmux = <0x6f00>;
					drive-strength = <0x04>;
				};
			};

			camera0_rst_output_low@gpio109 {
				phandle = <0x1c>;

				pins_cmd_dat {
					pinmux = <0x6d00>;
					output-low;
				};
			};

			camera0_rst_output_high@gpio109 {
				phandle = <0x1d>;

				pins_cmd_dat {
					pinmux = <0x6d00>;
					output-high;
				};
			};

			camera0_pdn_output_low@gpio98 {
				phandle = <0x1e>;

				pins_cmd_dat {
					pinmux = <0x6200>;
					output-low;
				};
			};

			camera0_pdn_output_high@gpio98 {
				phandle = <0x1f>;

				pins_cmd_dat {
					pinmux = <0x6200>;
					output-high;
				};
			};

			camera1_rst_output_low@gpio102 {
				phandle = <0x20>;

				pins_cmd_dat {
					pinmux = <0x6600>;
					output-low;
				};
			};

			camera1_rst_output_high@gpio102 {
				phandle = <0x21>;

				pins_cmd_dat {
					pinmux = <0x6600>;
					output-high;
				};
			};

			camera1_pdn_output_low@gpio98 {
				phandle = <0x22>;

				pins_cmd_dat {
					pinmux = <0x6200>;
					output-low;
				};
			};

			camera1_pdn_output_high@gpio98 {
				phandle = <0x23>;

				pins_cmd_dat {
					pinmux = <0x6200>;
					output-high;
				};
			};

			camera2_rst_output_low@gpio112 {
				phandle = <0x24>;

				pins_cmd_dat {
					pinmux = <0x7000>;
					output-low;
				};
			};

			camera2_rst_output_high@gpio112 {
				phandle = <0x25>;

				pins_cmd_dat {
					pinmux = <0x7000>;
					output-high;
				};
			};

			camera2_pdn_output_low@gpio110 {
				phandle = <0x26>;

				pins_cmd_dat {
					pinmux = <0x6e00>;
					output-low;
				};
			};

			camera2_pdn_output_high@gpio110 {
				phandle = <0x27>;

				pins_cmd_dat {
					pinmux = <0x6e00>;
					output-high;
				};
			};

			camera3_rst_output_low@gpio101 {
				phandle = <0x28>;

				pins_cmd_dat {
					pinmux = <0x6500>;
					output-low;
				};
			};

			camera3_rst_output_high@gpio101 {
				phandle = <0x29>;

				pins_cmd_dat {
					pinmux = <0x6500>;
					output-high;
				};
			};

			camera4_rst_output_low@gpio110 {
				phandle = <0x4a>;

				pins_cmd_dat {
					pinmux = <0x6e00>;
					output-low;
				};
			};

			camera4_rst_output_high@gpio110 {
				phandle = <0x4b>;

				pins_cmd_dat {
					pinmux = <0x6e00>;
					output-high;
				};
			};

			camera3_pdn_output_low@gpio24 {
				phandle = <0x2a>;

				pins_cmd_dat {
					pinmux = <0x1800>;
					output-low;
				};
			};

			camera3_pdn_output_high@gpio24 {
				phandle = <0x2b>;

				pins_cmd_dat {
					pinmux = <0x1800>;
					output-high;
				};
			};

			camera0_vcamd_output_low@gpio178 {
				phandle = <0x2d>;

				pins_cmd_dat {
					pinmux = <0xb200>;
					output-low;
				};
			};

			camera0_vcamd_output_high@gpio178 {
				phandle = <0x2c>;

				pins_cmd_dat {
					pinmux = <0xb200>;
					output-high;
				};
			};

			camera1_vcama_output_low@gpio107 {
				phandle = <0x2f>;

				pins_cmd_dat {
					pinmux = <0x6b00>;
					output-low;
				};
			};

			camera1_vcama_output_high@gpio107 {
				phandle = <0x2e>;

				pins_cmd_dat {
					pinmux = <0x6b00>;
					output-high;
				};
			};

			camera0_vcama_output_low@gpio107 {
				phandle = <0x31>;

				pins_cmd_dat {
					pinmux = <0x6b00>;
					output-low;
				};
			};

			camera0_vcama_output_high@gpio107 {
				phandle = <0x30>;

				pins_cmd_dat {
					pinmux = <0x6b00>;
					output-high;
				};
			};

			cam_mipi_switch_output_low@gpio21 {
				phandle = <0x41>;

				pins_cmd_dat {
					pinmux = <0x1500>;
					output-low;
				};
			};

			cam_mipi_switch_output_high@gpio21 {
				phandle = <0x42>;

				pins_cmd_dat {
					pinmux = <0x1500>;
					output-high;
				};
			};

			cam_mipi_switch_sel_output_low@gpio97 {
				phandle = <0x43>;

				pins_cmd_dat {
					pinmux = <0x6100>;
					output-low;
				};
			};

			cam_mipi_switch_sel_output_high@gpio97 {
				phandle = <0x44>;

				pins_cmd_dat {
					pinmux = <0x6100>;
					output-high;
				};
			};

			camera3_mclk_2mA@gpio99 {
				phandle = <0x46>;

				pins_cmd_dat {
					pinmux = <0x6301>;
					drive-strength = <0x02>;
				};
			};

			camera3_mclk_4mA@gpio99 {
				phandle = <0x47>;

				pins_cmd_dat {
					pinmux = <0x6301>;
					drive-strength = <0x04>;
				};
			};

			camera3_mclk_6mA@gpio99 {
				phandle = <0x48>;

				pins_cmd_dat {
					pinmux = <0x6301>;
					drive-strength = <0x06>;
				};
			};

			camera3_mclk_8mA@gpio99 {
				phandle = <0x49>;

				pins_cmd_dat {
					pinmux = <0x6301>;
					drive-strength = <0x07>;
				};
			};

			camera3_mclk_gpio_mode@gpio99 {
				phandle = <0x45>;

				pins_cmd_dat {
					pinmux = <0x6300>;
					drive-strength = <0x04>;
				};
			};

			camdefault {
				phandle = <0x1b>;
			};
		};
	};

	fragment@71 {
		target = <0xffffffff>;

		__overlay__ {
			cam0_enable_sensor = "monet_truly_main_ov12a10 monetd_truly_main_ov12a10";
			cam1_enable_sensor = "monet_hlt_front_gc5035 monet_txd_front_hi556 monet_hlt_custfront_gc5035 monet_hlt_front_gc5035B";
			cam3_enable_sensor = "monet_hlt_depth_ov02a1b";
			cam4_enable_sensor = "monet_hlt_macro_gc2375h monet_lh_macro_gc2375h monetd_cxt_depth_gc2375h";
			pinctrl-names = "default\0cam0_rst0\0cam0_rst1\0cam0_pnd0\0cam0_pnd1\0cam1_rst0\0cam1_rst1\0cam1_pnd0\0cam1_pnd1\0cam2_rst0\0cam2_rst1\0cam2_pnd0\0cam2_pnd1\0cam3_rst0\0cam3_rst1\0cam3_pnd0\0cam3_pnd1\0cam0_vcamd_on\0cam0_vcamd_off\0cam1_vcama_on\0cam1_vcama_off\0cam0_vcama_on\0cam0_vcama_off\0cam0_mclk_off\0cam0_mclk_2mA\0cam0_mclk_4mA\0cam0_mclk_6mA\0cam0_mclk_8mA\0cam1_mclk_off\0cam1_mclk_2mA\0cam1_mclk_4mA\0cam1_mclk_6mA\0cam1_mclk_8mA\0cam2_mclk_off\0cam2_mclk_2mA\0cam2_mclk_4mA\0cam2_mclk_6mA\0cam2_mclk_8mA\0cam_mipi_switch_en_0\0cam_mipi_switch_en_1\0cam_mipi_switch_sel_0\0cam_mipi_switch_sel_1\0cam3_mclk_off\0cam3_mclk_2mA\0cam3_mclk_4mA\0cam3_mclk_6mA\0cam3_mclk_8mA\0cam4_rst0\0cam4_rst1\0cam4_mclk_off\0cam4_mclk_2mA\0cam4_mclk_4mA\0cam4_mclk_6mA\0cam4_mclk_8mA";
			pinctrl-0 = <0x1b>;
			pinctrl-1 = <0x1c>;
			pinctrl-2 = <0x1d>;
			pinctrl-3 = <0x1e>;
			pinctrl-4 = <0x1f>;
			pinctrl-5 = <0x20>;
			pinctrl-6 = <0x21>;
			pinctrl-7 = <0x22>;
			pinctrl-8 = <0x23>;
			pinctrl-9 = <0x24>;
			pinctrl-10 = <0x25>;
			pinctrl-11 = <0x26>;
			pinctrl-12 = <0x27>;
			pinctrl-13 = <0x28>;
			pinctrl-14 = <0x29>;
			pinctrl-15 = <0x2a>;
			pinctrl-16 = <0x2b>;
			pinctrl-17 = <0x2c>;
			pinctrl-18 = <0x2d>;
			pinctrl-19 = <0x2e>;
			pinctrl-20 = <0x2f>;
			pinctrl-21 = <0x30>;
			pinctrl-22 = <0x31>;
			pinctrl-23 = <0x32>;
			pinctrl-24 = <0x33>;
			pinctrl-25 = <0x34>;
			pinctrl-26 = <0x35>;
			pinctrl-27 = <0x36>;
			pinctrl-28 = <0x37>;
			pinctrl-29 = <0x38>;
			pinctrl-30 = <0x39>;
			pinctrl-31 = <0x3a>;
			pinctrl-32 = <0x3b>;
			pinctrl-33 = <0x3c>;
			pinctrl-34 = <0x3d>;
			pinctrl-35 = <0x3e>;
			pinctrl-36 = <0x3f>;
			pinctrl-37 = <0x40>;
			pinctrl-38 = <0x41>;
			pinctrl-39 = <0x42>;
			pinctrl-40 = <0x43>;
			pinctrl-41 = <0x44>;
			pinctrl-42 = <0x45>;
			pinctrl-43 = <0x46>;
			pinctrl-44 = <0x47>;
			pinctrl-45 = <0x48>;
			pinctrl-46 = <0x49>;
			pinctrl-47 = <0x4a>;
			pinctrl-48 = <0x4b>;
			pinctrl-49 = <0x3c>;
			pinctrl-50 = <0x3d>;
			pinctrl-51 = <0x3e>;
			pinctrl-52 = <0x3f>;
			pinctrl-53 = <0x40>;
			cam0_vcama-supply = <0xffffffff>;
			cam2_vcama-supply = <0xffffffff>;
			cam1_vcama-supply = <0xffffffff>;
			cam3_vcama-supply = <0xffffffff>;
			cam4_vcama-supply = <0xffffffff>;
			cam2_vcamd-supply = <0xffffffff>;
			cam1_vcamd-supply = <0xffffffff>;
			cam0_vcamio-supply = <0xffffffff>;
			cam1_vcamio-supply = <0xffffffff>;
			cam2_vcamio-supply = <0xffffffff>;
			cam3_vcamio-supply = <0xffffffff>;
			cam4_vcamio-supply = <0xffffffff>;
			cam0_vcamaf-supply = <0xffffffff>;
			status = "okay";
		};
	};

	fragment@72 {
		target = <0xffffffff>;

		__overlay__ {
			pinctrl-names = "default\0hwen_high\0hwen_low";
			pinctrl-0 = <0x4c>;
			pinctrl-1 = <0x4d>;
			pinctrl-2 = <0x4e>;
			status = "okay";
		};
	};

	fragment@73 {
		target = <0xffffffff>;

		__overlay__ {

			default {
				phandle = <0x4c>;
			};

			hwen_high {
				phandle = <0x4d>;

				pins_cmd_dat {
					pinmux = <0x9800>;
					slew-rate = <0x01>;
					output-high;
				};
			};

			hwen_low {
				phandle = <0x4e>;

				pins_cmd_dat {
					pinmux = <0x9800>;
					slew-rate = <0x01>;
					output-low;
				};
			};
		};
	};

	__symbols__ {
		led0 = "/fragment@2/__overlay__/led@0";
		led1 = "/fragment@2/__overlay__/led@1";
		led2 = "/fragment@2/__overlay__/led@2";
		led3 = "/fragment@2/__overlay__/led@3";
		led4 = "/fragment@2/__overlay__/led@4";
		led5 = "/fragment@2/__overlay__/led@5";
		led6 = "/fragment@2/__overlay__/led@6";
		vibrator0 = "/fragment@2/__overlay__/vibrator@0";
		gsensor_1 = "/fragment@2/__overlay__/gsensor_1";
		gsensor_2 = "/fragment@2/__overlay__/gsensor_2";
		msensor_1 = "/fragment@2/__overlay__/msensor_1";
		msensor_2 = "/fragment@2/__overlay__/msensor_2";
		proximity_1 = "/fragment@2/__overlay__/proximity_1";
		light_1 = "/fragment@2/__overlay__/light_1";
		pick_up = "/fragment@2/__overlay__/pick_up";
		lux_aod = "/fragment@2/__overlay__/lux_aod";
		alsps_arch = "/fragment@2/__overlay__/alsps_arch";
		mtk_cali = "/fragment@2/__overlay__/mtk_cali";
		oplus_project = "/fragment@2/__overlay__/oplus_project";
		oppo_devinfo = "/fragment@2/__overlay__/oppo_devinfo";
		swtp = "/fragment@2/__overlay__/swtp";
		kpd_volume_down = "/fragment@2/__overlay__/kpd_volume_down";
		nfc_chipset = "/fragment@2/__overlay__/nfc_chipset";
		volume_down_gpio_eint = "/fragment@4/__overlay__/volume_down@0";
		uart0_rx_gpio_input = "/fragment@8/__overlay__/uart0_rx_gpio@gpio95";
		uart0_tx_gpio_input = "/fragment@8/__overlay__/uart0_tx_gpio@gpio96";
		silfp_default = "/fragment@15/__overlay__/silfpdefault";
		silfp_rst_low = "/fragment@15/__overlay__/state_reset_low";
		silfp_rst_high = "/fragment@15/__overlay__/state_reset_high";
		silfp_irq = "/fragment@15/__overlay__/fp_eint@5";
		fingerfp_power_high = "/fragment@15/__overlay__/state_power_high";
		fingerfp_power_low = "/fragment@15/__overlay__/state_power_low";
		gpio_id0_up = "/fragment@16/__overlay__/gpio_id0_up";
		gpio_id0_down = "/fragment@16/__overlay__/gpio_id0_down";
		ctp_novatek_spi_mode = "/fragment@18/__overlay__/ctp_novatek_spi_mode";
		consys_pins_default = "/fragment@23/__overlay__/consys_default";
		gpslna_pins_init = "/fragment@23/__overlay__/gpslna@0";
		gpslna_pins_oh = "/fragment@23/__overlay__/gpslna@1";
		gpslna_pins_ol = "/fragment@23/__overlay__/gpslna@2";
		irtx_gpio_led_default = "/fragment@26/__overlay__/irtx_gpio_led_def@gpio12";
		irtx_gpio_led_set = "/fragment@26/__overlay__/irtx_gpio_led_set@gpio12";
		mtkfb_pins_lcm_rst_out1_gpio = "/fragment@27/__overlay__/lcm_rst_out1_gpio";
		mtkfb_pins_lcm_rst_out0_gpio = "/fragment@27/__overlay__/lcm_rst_out0_gpio";
		mtkfb_pins_lcm_dsi_te = "/fragment@27/__overlay__/lcm_dsi_te";
		mtkfb_pins_lcm_reset0 = "/fragment@29/__overlay__/lcm_rst_out0_gpio";
		mtkfb_pins_lcm_reset1 = "/fragment@29/__overlay__/lcm_rst_out1_gpio";
		mtkfb_pins_lcd_bias_enp0 = "/fragment@29/__overlay__/lcd_bias_enp0_gpio";
		mtkfb_pins_lcd_bias_enp1 = "/fragment@29/__overlay__/lcd_bias_enp1_gpio";
		mtkfb_pins_lcd_bias_enn0 = "/fragment@29/__overlay__/lcd_bias_enn0_gpio";
		mtkfb_pins_lcd_bias_enn1 = "/fragment@29/__overlay__/lcd_bias_enn1_gpio";
		otg_iddg_high = "/fragment@35/__overlay__/otg_iddg_high";
		otg_gpio_low = "/fragment@35/__overlay__/otg_gpio_low";
		cap_touch_mtk = "/fragment@39/__overlay__/cap_touch@5d";
		camera_main_mtk = "/fragment@41/__overlay__/camera_main@6c";
		camera_main_eeprom_mtk = "/fragment@41/__overlay__/camera_main_eeprom@50";
		camera_main_af_mtk = "/fragment@41/__overlay__/camera_main_af@18";
		ccu_sensor_i2c_2_hw_mtk = "/fragment@41/__overlay__/ccu_sensor_i2c_2_hw@11";
		nfc_mtk = "/fragment@42/__overlay__/nfc@08";
		camera_main_three_mtk = "/fragment@43/__overlay__/camera_main_three@2e";
		camera_sub_two_mtk = "/fragment@43/__overlay__/camera_sub_two@7a";
		camera_main_two_mtk = "/fragment@43/__overlay__/camera_main_two@6c";
		camera_sub_mtk = "/fragment@43/__overlay__/camera_sub@6e";
		camera_sub_eeprom_mtk = "/fragment@43/__overlay__/camera_sub_eeprom@52";
		camera_main_two_eeprom_mtk = "/fragment@43/__overlay__/camera_main_two_eeprom@54";
		ccu_sensor_i2c_4_hw_mtk = "/fragment@43/__overlay__/ccu_sensor_i2c_4_hw@12";
		camera_sub_two_eeprom_mtk = "/fragment@43/__overlay__/camera_sub_two_eeprom@a4";
		subpmic_pmu_mtk = "/fragment@44/__overlay__/subpmic_pmu@34";
		usb_type_c_mtk = "/fragment@44/__overlay__/usb_type_c@4e";
		strobe_main_mtk = "/fragment@45/__overlay__/strobe_main@63";
		speaker_amp_mtk = "/fragment@46/__overlay__/speaker_amp@34";
		slave_charger_mtk = "/fragment@46/__overlay__/slave_charger@4b";
		camera0_mclk_2mA = "/fragment@70/__overlay__/camera0_mclk_2mA@gpio108";
		camera0_mclk_4mA = "/fragment@70/__overlay__/camera0_mclk_4mA@gpio108";
		camera0_mclk_6mA = "/fragment@70/__overlay__/camera0_mclk_6mA@gpio108";
		camera0_mclk_8mA = "/fragment@70/__overlay__/camera0_mclk_8mA@gpio108";
		camera0_mclk_off = "/fragment@70/__overlay__/camera0_mclk_gpio_mode@gpio108";
		camera1_mclk_2mA = "/fragment@70/__overlay__/camera1_mclk_2mA@gpio100";
		camera1_mclk_4mA = "/fragment@70/__overlay__/camera1_mclk_4mA@gpio100";
		camera1_mclk_6mA = "/fragment@70/__overlay__/camera1_mclk_6mA@gpio100";
		camera1_mclk_8mA = "/fragment@70/__overlay__/camera1_mclk_8mA@gpio100";
		camera1_mclk_off = "/fragment@70/__overlay__/camera1_mclk_gpio_mode@gpio100";
		camera2_mclk_2mA = "/fragment@70/__overlay__/camera2_mclk_2mA@gpio111";
		camera2_mclk_4mA = "/fragment@70/__overlay__/camera2_mclk_4mA@gpio111";
		camera2_mclk_6mA = "/fragment@70/__overlay__/camera2_mclk_6mA@gpio111";
		camera2_mclk_8mA = "/fragment@70/__overlay__/camera2_mclk_8mA@gpio111";
		camera2_mclk_off = "/fragment@70/__overlay__/camera2_mclk_gpio_mode@gpio111";
		camera0_rst_low = "/fragment@70/__overlay__/camera0_rst_output_low@gpio109";
		camera0_rst_high = "/fragment@70/__overlay__/camera0_rst_output_high@gpio109";
		camera0_pdn_low = "/fragment@70/__overlay__/camera0_pdn_output_low@gpio98";
		camera0_pdn_high = "/fragment@70/__overlay__/camera0_pdn_output_high@gpio98";
		camera1_rst_low = "/fragment@70/__overlay__/camera1_rst_output_low@gpio102";
		camera1_rst_high = "/fragment@70/__overlay__/camera1_rst_output_high@gpio102";
		camera1_pdn_low = "/fragment@70/__overlay__/camera1_pdn_output_low@gpio98";
		camera1_pdn_high = "/fragment@70/__overlay__/camera1_pdn_output_high@gpio98";
		camera2_rst_low = "/fragment@70/__overlay__/camera2_rst_output_low@gpio112";
		camera2_rst_high = "/fragment@70/__overlay__/camera2_rst_output_high@gpio112";
		camera2_pdn_low = "/fragment@70/__overlay__/camera2_pdn_output_low@gpio110";
		camera2_pdn_high = "/fragment@70/__overlay__/camera2_pdn_output_high@gpio110";
		camera3_rst_low = "/fragment@70/__overlay__/camera3_rst_output_low@gpio101";
		camera3_rst_high = "/fragment@70/__overlay__/camera3_rst_output_high@gpio101";
		camera4_rst_low = "/fragment@70/__overlay__/camera4_rst_output_low@gpio110";
		camera4_rst_high = "/fragment@70/__overlay__/camera4_rst_output_high@gpio110";
		camera3_pdn_low = "/fragment@70/__overlay__/camera3_pdn_output_low@gpio24";
		camera3_pdn_high = "/fragment@70/__overlay__/camera3_pdn_output_high@gpio24";
		camera0_vcamd_off = "/fragment@70/__overlay__/camera0_vcamd_output_low@gpio178";
		camera0_vcamd_on = "/fragment@70/__overlay__/camera0_vcamd_output_high@gpio178";
		camera1_vcama_off = "/fragment@70/__overlay__/camera1_vcama_output_low@gpio107";
		camera1_vcama_on = "/fragment@70/__overlay__/camera1_vcama_output_high@gpio107";
		camera0_vcama_off = "/fragment@70/__overlay__/camera0_vcama_output_low@gpio107";
		camera0_vcama_on = "/fragment@70/__overlay__/camera0_vcama_output_high@gpio107";
		cam_mipi_switch_low = "/fragment@70/__overlay__/cam_mipi_switch_output_low@gpio21";
		cam_mipi_switch_high = "/fragment@70/__overlay__/cam_mipi_switch_output_high@gpio21";
		cam_mipi_switch_sel_low = "/fragment@70/__overlay__/cam_mipi_switch_sel_output_low@gpio97";
		cam_mipi_switch_sel_high = "/fragment@70/__overlay__/cam_mipi_switch_sel_output_high@gpio97";
		camera3_mclk_2mA = "/fragment@70/__overlay__/camera3_mclk_2mA@gpio99";
		camera3_mclk_4mA = "/fragment@70/__overlay__/camera3_mclk_4mA@gpio99";
		camera3_mclk_6mA = "/fragment@70/__overlay__/camera3_mclk_6mA@gpio99";
		camera3_mclk_8mA = "/fragment@70/__overlay__/camera3_mclk_8mA@gpio99";
		camera3_mclk_off = "/fragment@70/__overlay__/camera3_mclk_gpio_mode@gpio99";
		camera_pins_default = "/fragment@70/__overlay__/camdefault";
		flashlights_monet_pins_default = "/fragment@73/__overlay__/default";
		flashlights_monet_pins_hwen_high = "/fragment@73/__overlay__/hwen_high";
		flashlights_monet_pins_hwen_low = "/fragment@73/__overlay__/hwen_low";
	};

	__fixups__ {
		reserved_memory = "/fragment@0:target:0";
		chosen = "/fragment@1:target:0";
		odm = "/fragment@2:target:0";
		pio = "/fragment@2/__overlay__/swtp:interrupt-parent:0\0/fragment@2/__overlay__/swtp:deb-gpios:0\0/fragment@2/__overlay__/kpd_volume_down:interrupt-parent:0\0/fragment@3/__overlay__:keypad,volume-down:0\0/fragment@4:target:0\0/fragment@6/__overlay__/nfc_nxp@28:nxp,pn544-irq:0\0/fragment@6/__overlay__/nfc_nxp@28:nxp,pn544-ven:0\0/fragment@6/__overlay__/nfc_nxp@28:nxp,pn544-fw-dwnld:0\0/fragment@6/__overlay__/nfc_nxp@28:interrupt-parent:0\0/fragment@8:target:0\0/fragment@15:target:0\0/fragment@16:target:0\0/fragment@17/__overlay__:oplus,fp_gpio_0:0\0/fragment@18:target:0\0/fragment@19/__overlay__/touchscreen@0:interrupt-parent:0\0/fragment@19/__overlay__/touchscreen@0:irq-gpio:0\0/fragment@19/__overlay__/touchscreen@0:reset-gpio:0\0/fragment@21/__overlay__:mt6370,intr_gpio:0\0/fragment@22/__overlay__:mt6370pd,intr_gpio:0\0/fragment@23:target:0\0/fragment@26:target:0\0/fragment@27:target:0\0/fragment@29:target:0\0/fragment@32/__overlay__/rt-swchg@53:rt,intr_gpio:0\0/fragment@34/__overlay__:interrupt-parent:0\0/fragment@35:target:0\0/fragment@48/__overlay__:GPIO_FDD_BAND_SUPPORT_DETECT_5TH_PIN:0\0/fragment@48/__overlay__:GPIO_FDD_BAND_SUPPORT_DETECT_1ST_PIN:0\0/fragment@48/__overlay__:GPIO_FDD_BAND_SUPPORT_DETECT_3RD_PIN:0\0/fragment@48/__overlay__:GPIO_SIM2_HOT_PLUG:0\0/fragment@48/__overlay__:GPIO_SIM1_HOT_PLUG:0\0/fragment@48/__overlay__:GPIO_FDD_BAND_SUPPORT_DETECT_2ND_PIN:0\0/fragment@48/__overlay__:GPIO_SIM2_SIO:0\0/fragment@48/__overlay__:GPIO_SIM2_SRST:0\0/fragment@48/__overlay__:GPIO_SIM2_SCLK:0\0/fragment@48/__overlay__:GPIO_SIM1_SCLK:0\0/fragment@48/__overlay__:GPIO_SIM1_SRST:0\0/fragment@48/__overlay__:GPIO_SIM1_SIO:0\0/fragment@48/__overlay__:GPIO_FDD_BAND_SUPPORT_DETECT_4TH_PIN:0\0/fragment@50/__overlay__:interrupt-parent:0\0/fragment@50/__overlay__:deb-gpios:0\0/fragment@51/__overlay__:interrupt-parent:0\0/fragment@52/__overlay__:interrupt-parent:0\0/fragment@53/__overlay__:interrupt-parent:0\0/fragment@54/__overlay__:interrupt-parent:0\0/fragment@55/__overlay__:interrupt-parent:0\0/fragment@56/__overlay__:interrupt-parent:0\0/fragment@57/__overlay__:interrupt-parent:0\0/fragment@70:target:0\0/fragment@73:target:0";
		keypad = "/fragment@3:target:0\0/fragment@69:target:0";
		i2c2 = "/fragment@5:target:0\0/fragment@41:target:0";
		i2c3 = "/fragment@6:target:0\0/fragment@42:target:0";
		apuart0 = "/fragment@7:target:0";
		mt_charger = "/fragment@9:target:0";
		lk_charger = "/fragment@10:target:0";
		charger = "/fragment@11:target:0\0/fragment@33:target:0";
		oplus_fast_charger = "/fragment@12:target:0";
		spi5 = "/fragment@13:target:0";
		egis_fp = "/fragment@14:target:0\0/fragment@52:target:0";
		oplus_fp_common = "/fragment@17:target:0";
		spi2 = "/fragment@19:target:0";
		accdet = "/fragment@20:target:0";
		mt6370_pmu = "/fragment@21:target:0";
		mt6370_typec = "/fragment@22:target:0";
		consys = "/fragment@24:target:0";
		irtx_pwm = "/fragment@25:target:0";
		mtkfb = "/fragment@28:target:0";
		mt6358_snd = "/fragment@30:target:0";
		bat_gm30 = "/fragment@31:target:0";
		auxadc = "/fragment@31/__overlay__:io-channels:0\0/fragment@36:target:0\0/fragment@37/__overlay__:io-channels:0";
		i2c7 = "/fragment@32:target:0\0/fragment@46:target:0";
		otg_iddig = "/fragment@34:target:0";
		md_auxadc = "/fragment@37:target:0";
		pmic_clock_buffer_ctrl = "/fragment@38:target:0";
		i2c0 = "/fragment@39:target:0";
		i2c1 = "/fragment@40:target:0";
		i2c4 = "/fragment@43:target:0";
		i2c5 = "/fragment@44:target:0";
		i2c6 = "/fragment@45:target:0";
		i2c8 = "/fragment@47:target:0";
		gpio_usage_mapping = "/fragment@48:target:0";
		gpio = "/fragment@49:target:0";
		mrdump_ext_rst = "/fragment@50:target:0";
		touch = "/fragment@51:target:0\0/fragment@68:target:0";
		irq_nfc = "/fragment@53:target:0";
		subpmic_pmu_eint = "/fragment@54:target:0";
		smart_pa = "/fragment@55:target:0";
		dsi_te = "/fragment@56:target:0";
		main_pmic = "/fragment@57:target:0";
		md1_sim1_hot_plug_eint = "/fragment@58:target:0";
		md1_sim2_hot_plug_eint = "/fragment@59:target:0";
		mt_pmic_vcama1_ldo_reg = "/fragment@60:target:0\0/fragment@67/__overlay__:vcama-supply:0\0/fragment@67/__overlay__:vcama_main2-supply:0\0/fragment@67/__overlay__:vcama_sub-supply:0\0/fragment@71/__overlay__:cam0_vcama-supply:0\0/fragment@71/__overlay__:cam2_vcama-supply:0\0/fragment@71/__overlay__:cam1_vcama-supply:0";
		mt_pmic_vcama2_ldo_reg = "/fragment@61:target:0\0/fragment@67/__overlay__:vcama_sub2-supply:0\0/fragment@67/__overlay__:vcama_main3-supply:0\0/fragment@71/__overlay__:cam3_vcama-supply:0\0/fragment@71/__overlay__:cam4_vcama-supply:0";
		mt_pmic_vsim1_ldo_reg = "/fragment@62:target:0";
		mt_pmic_vsim2_ldo_reg = "/fragment@63:target:0";
		mt_pmic_vcamd_ldo_reg = "/fragment@64:target:0\0/fragment@67/__overlay__:vcamd_main2-supply:0\0/fragment@67/__overlay__:vcamd_sub-supply:0\0/fragment@71/__overlay__:cam2_vcamd-supply:0\0/fragment@71/__overlay__:cam1_vcamd-supply:0";
		mt_pmic_vcamio_ldo_reg = "/fragment@65:target:0\0/fragment@67/__overlay__:vcamio-supply:0\0/fragment@67/__overlay__:vcamio_sub-supply:0\0/fragment@67/__overlay__:vcamio_main2-supply:0\0/fragment@67/__overlay__:vcamio_sub2-supply:0\0/fragment@67/__overlay__:vcamio_main3-supply:0\0/fragment@71/__overlay__:cam0_vcamio-supply:0\0/fragment@71/__overlay__:cam1_vcamio-supply:0\0/fragment@71/__overlay__:cam2_vcamio-supply:0\0/fragment@71/__overlay__:cam3_vcamio-supply:0\0/fragment@71/__overlay__:cam4_vcamio-supply:0";
		mt_pmic_vldo28_ldo_reg = "/fragment@66:target:0\0/fragment@67/__overlay__:vcamaf-supply:0\0/fragment@67/__overlay__:vcamaf_sub-supply:0\0/fragment@67/__overlay__:vcamaf_main2-supply:0\0/fragment@68/__overlay__:vtouch-supply:0\0/fragment@71/__overlay__:cam0_vcamaf-supply:0";
		kd_camera_hw1 = "/fragment@67:target:0\0/fragment@71:target:0";
		flashlights_monet = "/fragment@72:target:0";
	};

	__local_fixups__ {

		fragment@3 {

			__overlay__ {
				pinctrl-0 = <0x00>;
			};
		};

		fragment@7 {

			__overlay__ {
				pinctrl-0 = <0x00>;
				pinctrl-1 = <0x00>;
			};
		};

		fragment@14 {

			__overlay__ {
				pinctrl-0 = <0x00>;
				pinctrl-1 = <0x00>;
				pinctrl-2 = <0x00>;
				pinctrl-3 = <0x00>;
				pinctrl-4 = <0x00>;
				pinctrl-5 = <0x00>;
			};
		};

		fragment@17 {

			__overlay__ {
				pinctrl-0 = <0x00>;
				pinctrl-1 = <0x00>;
			};
		};

		fragment@19 {

			__overlay__ {

				touchscreen@0 {
					pinctrl-0 = <0x00>;
				};
			};
		};

		fragment@24 {

			__overlay__ {
				pinctrl-0 = <0x00>;
				pinctrl-1 = <0x00>;
				pinctrl-2 = <0x00>;
				pinctrl-3 = <0x00>;
			};
		};

		fragment@25 {

			__overlay__ {
				pinctrl-0 = <0x00>;
				pinctrl-1 = <0x00>;
			};
		};

		fragment@28 {

			__overlay__ {
				pinctrl-0 = <0x00>;
				pinctrl-1 = <0x00>;
				pinctrl-2 = <0x00>;
				pinctrl-3 = <0x00>;
				pinctrl-4 = <0x00>;
				pinctrl-5 = <0x00>;
			};
		};

		fragment@34 {

			__overlay__ {
				pinctrl-0 = <0x00>;
				pinctrl-1 = <0x00>;
			};
		};

		fragment@71 {

			__overlay__ {
				pinctrl-0 = <0x00>;
				pinctrl-1 = <0x00>;
				pinctrl-2 = <0x00>;
				pinctrl-3 = <0x00>;
				pinctrl-4 = <0x00>;
				pinctrl-5 = <0x00>;
				pinctrl-6 = <0x00>;
				pinctrl-7 = <0x00>;
				pinctrl-8 = <0x00>;
				pinctrl-9 = <0x00>;
				pinctrl-10 = <0x00>;
				pinctrl-11 = <0x00>;
				pinctrl-12 = <0x00>;
				pinctrl-13 = <0x00>;
				pinctrl-14 = <0x00>;
				pinctrl-15 = <0x00>;
				pinctrl-16 = <0x00>;
				pinctrl-17 = <0x00>;
				pinctrl-18 = <0x00>;
				pinctrl-19 = <0x00>;
				pinctrl-20 = <0x00>;
				pinctrl-21 = <0x00>;
				pinctrl-22 = <0x00>;
				pinctrl-23 = <0x00>;
				pinctrl-24 = <0x00>;
				pinctrl-25 = <0x00>;
				pinctrl-26 = <0x00>;
				pinctrl-27 = <0x00>;
				pinctrl-28 = <0x00>;
				pinctrl-29 = <0x00>;
				pinctrl-30 = <0x00>;
				pinctrl-31 = <0x00>;
				pinctrl-32 = <0x00>;
				pinctrl-33 = <0x00>;
				pinctrl-34 = <0x00>;
				pinctrl-35 = <0x00>;
				pinctrl-36 = <0x00>;
				pinctrl-37 = <0x00>;
				pinctrl-38 = <0x00>;
				pinctrl-39 = <0x00>;
				pinctrl-40 = <0x00>;
				pinctrl-41 = <0x00>;
				pinctrl-42 = <0x00>;
				pinctrl-43 = <0x00>;
				pinctrl-44 = <0x00>;
				pinctrl-45 = <0x00>;
				pinctrl-46 = <0x00>;
				pinctrl-47 = <0x00>;
				pinctrl-48 = <0x00>;
				pinctrl-49 = <0x00>;
				pinctrl-50 = <0x00>;
				pinctrl-51 = <0x00>;
				pinctrl-52 = <0x00>;
				pinctrl-53 = <0x00>;
			};
		};

		fragment@72 {

			__overlay__ {
				pinctrl-0 = <0x00>;
				pinctrl-1 = <0x00>;
				pinctrl-2 = <0x00>;
			};
		};
	};
};
